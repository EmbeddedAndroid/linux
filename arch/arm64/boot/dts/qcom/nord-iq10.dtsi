// SPDX-License-Identifier: BSD-3-Clause
/*
 * Copyright (c) Qualcomm Technologies, Inc. and/or its subsidiaries.
 */

#include <dt-bindings/clock/qcom,nord-gcc.h>
#include <dt-bindings/clock/qcom,nord-negcc.h>
#include <dt-bindings/clock/qcom,nord-nwgcc.h>
#include <dt-bindings/clock/qcom,nord-segcc.h>
#include <dt-bindings/clock/qcom,nord-tcsrcc.h>
#include <dt-bindings/clock/qcom,nord-gpucc.h>
#include <dt-bindings/clock/qcom,nord-dispcc.h>
#include <dt-bindings/clock/qcom,rpmh.h>
#include <dt-bindings/phy/phy-qcom-qmp.h>
#include <dt-bindings/interconnect/qcom,icc.h>
#include <dt-bindings/interconnect/qcom,nord-rpmh.h>
#include <dt-bindings/power/qcom-rpmpd.h>
#include <dt-bindings/soc/qcom,rpmh-rsc.h>

#include "nord.dtsi"

/ {
	clk_virt: interconnect-clk-virt {
		compatible = "qcom,nord-clk-virt";
		#interconnect-cells = <2>;
		qcom,bcm-voters = <&apps_bcm_voter>;
	};

	mc_virt: interconnect-mc-virt {
		compatible = "qcom,nord-mc-virt";
		#interconnect-cells = <2>;
		qcom,bcm-voters = <&apps_bcm_voter>;
	};
};

&i2c0 {
	clocks = <&segcc SE_GCC_QUPV3_WRAP0_S0_CLK>;
	clock-names = "se";
	interconnects = <&clk_virt MASTER_QUP_CORE_0 QCOM_ICC_TAG_ALWAYS
			 &clk_virt SLAVE_QUP_CORE_0 QCOM_ICC_TAG_ALWAYS>,
			<&hscnoc MASTER_APPSS_PROC QCOM_ICC_TAG_ALWAYS
			 &config_noc SLAVE_QUP_0 QCOM_ICC_TAG_ALWAYS>,
			<&aggre2_noc_tile MASTER_QUP_0 QCOM_ICC_TAG_ALWAYS
			 &mc_virt SLAVE_EBI1 QCOM_ICC_TAG_ALWAYS>;
	interconnect-names = "qup-core", "qup-config", "qup-memory";
	pinctrl-0 = <&qup_i2c0_default>;
	pinctrl-names = "default";
};

&i2c1 {
	clocks = <&segcc SE_GCC_QUPV3_WRAP0_S1_CLK>;
	clock-names = "se";
	interconnects = <&clk_virt MASTER_QUP_CORE_0 QCOM_ICC_TAG_ALWAYS
			 &clk_virt SLAVE_QUP_CORE_0 QCOM_ICC_TAG_ALWAYS>,
			<&hscnoc MASTER_APPSS_PROC QCOM_ICC_TAG_ALWAYS
			 &config_noc SLAVE_QUP_0 QCOM_ICC_TAG_ALWAYS>,
			<&aggre2_noc_tile MASTER_QUP_0 QCOM_ICC_TAG_ALWAYS
			 &mc_virt SLAVE_EBI1 QCOM_ICC_TAG_ALWAYS>;
	interconnect-names = "qup-core", "qup-config", "qup-memory";
	pinctrl-0 = <&qup_i2c1_default>;
	pinctrl-names = "default";
};

&i2c2 {
	clocks = <&segcc SE_GCC_QUPV3_WRAP0_S2_CLK>;
	clock-names = "se";
	interconnects = <&clk_virt MASTER_QUP_CORE_0 QCOM_ICC_TAG_ALWAYS
			 &clk_virt SLAVE_QUP_CORE_0 QCOM_ICC_TAG_ALWAYS>,
			<&hscnoc MASTER_APPSS_PROC QCOM_ICC_TAG_ALWAYS
			 &config_noc SLAVE_QUP_0 QCOM_ICC_TAG_ALWAYS>,
			<&aggre2_noc_tile MASTER_QUP_0 QCOM_ICC_TAG_ALWAYS
			 &mc_virt SLAVE_EBI1 QCOM_ICC_TAG_ALWAYS>;
	interconnect-names = "qup-core", "qup-config", "qup-memory";
	pinctrl-0 = <&qup_i2c2_default>;
	pinctrl-names = "default";
};

&i2c3 {
	clocks = <&segcc SE_GCC_QUPV3_WRAP0_S3_CLK>;
	clock-names = "se";
	interconnects = <&clk_virt MASTER_QUP_CORE_0 QCOM_ICC_TAG_ALWAYS
			 &clk_virt SLAVE_QUP_CORE_0 QCOM_ICC_TAG_ALWAYS>,
			<&hscnoc MASTER_APPSS_PROC QCOM_ICC_TAG_ALWAYS
			 &config_noc SLAVE_QUP_0 QCOM_ICC_TAG_ALWAYS>,
			<&aggre2_noc_tile MASTER_QUP_0 QCOM_ICC_TAG_ALWAYS
			 &mc_virt SLAVE_EBI1 QCOM_ICC_TAG_ALWAYS>;
	interconnect-names = "qup-core", "qup-config", "qup-memory";
	pinctrl-0 = <&qup_i2c3_default>;
	pinctrl-names = "default";
};

&i2c4 {
	clocks = <&segcc SE_GCC_QUPV3_WRAP0_S4_CLK>;
	clock-names = "se";
	interconnects = <&clk_virt MASTER_QUP_CORE_0 QCOM_ICC_TAG_ALWAYS
			 &clk_virt SLAVE_QUP_CORE_0 QCOM_ICC_TAG_ALWAYS>,
			<&hscnoc MASTER_APPSS_PROC QCOM_ICC_TAG_ALWAYS
			 &config_noc SLAVE_QUP_0 QCOM_ICC_TAG_ALWAYS>,
			<&aggre2_noc_tile MASTER_QUP_0 QCOM_ICC_TAG_ALWAYS
			 &mc_virt SLAVE_EBI1 QCOM_ICC_TAG_ALWAYS>;
	interconnect-names = "qup-core", "qup-config", "qup-memory";
	pinctrl-0 = <&qup_i2c4_default>;
	pinctrl-names = "default";
};

&i2c5 {
	clocks = <&segcc SE_GCC_QUPV3_WRAP0_S5_CLK>;
	clock-names = "se";
	interconnects = <&clk_virt MASTER_QUP_CORE_0 QCOM_ICC_TAG_ALWAYS
			 &clk_virt SLAVE_QUP_CORE_0 QCOM_ICC_TAG_ALWAYS>,
			<&hscnoc MASTER_APPSS_PROC QCOM_ICC_TAG_ALWAYS
			 &config_noc SLAVE_QUP_0 QCOM_ICC_TAG_ALWAYS>,
			<&aggre2_noc_tile MASTER_QUP_0 QCOM_ICC_TAG_ALWAYS
			 &mc_virt SLAVE_EBI1 QCOM_ICC_TAG_ALWAYS>;
	interconnect-names = "qup-core", "qup-config", "qup-memory";
	pinctrl-0 = <&qup_i2c5_default>;
	pinctrl-names = "default";
};

&i2c7 {
	clocks = <&segcc SE_GCC_QUPV3_WRAP1_S0_CLK>;
	clock-names = "se";
	interconnects = <&clk_virt MASTER_QUP_CORE_1 QCOM_ICC_TAG_ALWAYS
			 &clk_virt SLAVE_QUP_CORE_1 QCOM_ICC_TAG_ALWAYS>,
			<&hscnoc MASTER_APPSS_PROC QCOM_ICC_TAG_ALWAYS
			 &config_noc SLAVE_QUP_1 QCOM_ICC_TAG_ALWAYS>,
			<&aggre2_noc_tile MASTER_QUP_1 QCOM_ICC_TAG_ALWAYS
			 &mc_virt SLAVE_EBI1 QCOM_ICC_TAG_ALWAYS>;
	interconnect-names = "qup-core", "qup-config", "qup-memory";
	pinctrl-0 = <&qup_i2c7_default>;
	pinctrl-names = "default";
};

&i2c8 {
	clocks = <&segcc SE_GCC_QUPV3_WRAP1_S1_CLK>;
	clock-names = "se";
	interconnects = <&clk_virt MASTER_QUP_CORE_1 QCOM_ICC_TAG_ALWAYS
			 &clk_virt SLAVE_QUP_CORE_1 QCOM_ICC_TAG_ALWAYS>,
			<&hscnoc MASTER_APPSS_PROC QCOM_ICC_TAG_ALWAYS
			 &config_noc SLAVE_QUP_1 QCOM_ICC_TAG_ALWAYS>,
			<&aggre2_noc_tile MASTER_QUP_1 QCOM_ICC_TAG_ALWAYS
			 &mc_virt SLAVE_EBI1 QCOM_ICC_TAG_ALWAYS>;
	interconnect-names = "qup-core", "qup-config", "qup-memory";
	pinctrl-0 = <&qup_i2c8_default>;
	pinctrl-names = "default";
};

&i2c9 {
	clocks = <&segcc SE_GCC_QUPV3_WRAP1_S2_CLK>;
	clock-names = "se";
	interconnects = <&clk_virt MASTER_QUP_CORE_1 QCOM_ICC_TAG_ALWAYS
			 &clk_virt SLAVE_QUP_CORE_1 QCOM_ICC_TAG_ALWAYS>,
			<&hscnoc MASTER_APPSS_PROC QCOM_ICC_TAG_ALWAYS
			 &config_noc SLAVE_QUP_1 QCOM_ICC_TAG_ALWAYS>,
			<&aggre2_noc_tile MASTER_QUP_1 QCOM_ICC_TAG_ALWAYS
			 &mc_virt SLAVE_EBI1 QCOM_ICC_TAG_ALWAYS>;
	interconnect-names = "qup-core", "qup-config", "qup-memory";
	pinctrl-0 = <&qup_i2c9_default>;
	pinctrl-names = "default";
};

&i2c10 {
	clocks = <&segcc SE_GCC_QUPV3_WRAP1_S3_CLK>;
	clock-names = "se";
	interconnects = <&clk_virt MASTER_QUP_CORE_1 QCOM_ICC_TAG_ALWAYS
			 &clk_virt SLAVE_QUP_CORE_1 QCOM_ICC_TAG_ALWAYS>,
			<&hscnoc MASTER_APPSS_PROC QCOM_ICC_TAG_ALWAYS
			 &config_noc SLAVE_QUP_1 QCOM_ICC_TAG_ALWAYS>,
			<&aggre2_noc_tile MASTER_QUP_1 QCOM_ICC_TAG_ALWAYS
			 &mc_virt SLAVE_EBI1 QCOM_ICC_TAG_ALWAYS>;
	interconnect-names = "qup-core", "qup-config", "qup-memory";
	pinctrl-0 = <&qup_i2c10_default>;
	pinctrl-names = "default";
};

&i2c11 {
	clocks = <&segcc SE_GCC_QUPV3_WRAP1_S4_CLK>;
	clock-names = "se";
	interconnects = <&clk_virt MASTER_QUP_CORE_1 QCOM_ICC_TAG_ALWAYS
			 &clk_virt SLAVE_QUP_CORE_1 QCOM_ICC_TAG_ALWAYS>,
			<&hscnoc MASTER_APPSS_PROC QCOM_ICC_TAG_ALWAYS
			 &config_noc SLAVE_QUP_1 QCOM_ICC_TAG_ALWAYS>,
			<&aggre2_noc_tile MASTER_QUP_1 QCOM_ICC_TAG_ALWAYS
			 &mc_virt SLAVE_EBI1 QCOM_ICC_TAG_ALWAYS>;
	interconnect-names = "qup-core", "qup-config", "qup-memory";
	pinctrl-0 = <&qup_i2c11_default>;
	pinctrl-names = "default";
};

&i2c12 {
	clocks = <&segcc SE_GCC_QUPV3_WRAP1_S5_CLK>;
	clock-names = "se";
	interconnects = <&clk_virt MASTER_QUP_CORE_1 QCOM_ICC_TAG_ALWAYS
			 &clk_virt SLAVE_QUP_CORE_1 QCOM_ICC_TAG_ALWAYS>,
			<&hscnoc MASTER_APPSS_PROC QCOM_ICC_TAG_ALWAYS
			 &config_noc SLAVE_QUP_1 QCOM_ICC_TAG_ALWAYS>,
			<&aggre2_noc_tile MASTER_QUP_1 QCOM_ICC_TAG_ALWAYS
			 &mc_virt SLAVE_EBI1 QCOM_ICC_TAG_ALWAYS>;
	interconnect-names = "qup-core", "qup-config", "qup-memory";
	pinctrl-0 = <&qup_i2c12_default>;
	pinctrl-names = "default";
};

&i2c13 {
	clocks = <&segcc SE_GCC_QUPV3_WRAP1_S6_CLK>;
	clock-names = "se";
	interconnects = <&clk_virt MASTER_QUP_CORE_1 QCOM_ICC_TAG_ALWAYS
			 &clk_virt SLAVE_QUP_CORE_1 QCOM_ICC_TAG_ALWAYS>,
			<&hscnoc MASTER_APPSS_PROC QCOM_ICC_TAG_ALWAYS
			 &config_noc SLAVE_QUP_1 QCOM_ICC_TAG_ALWAYS>,
			<&aggre2_noc_tile MASTER_QUP_1 QCOM_ICC_TAG_ALWAYS
			 &mc_virt SLAVE_EBI1 QCOM_ICC_TAG_ALWAYS>;
	interconnect-names = "qup-core", "qup-config", "qup-memory";
	pinctrl-0 = <&qup_i2c13_default>;
	pinctrl-names = "default";
};

&i2c14 {
	clocks = <&negcc NE_GCC_QUPV3_WRAP2_S0_CLK>;
	clock-names = "se";
	interconnects = <&clk_virt MASTER_QUP_CORE_2 QCOM_ICC_TAG_ALWAYS
			 &clk_virt SLAVE_QUP_CORE_2 QCOM_ICC_TAG_ALWAYS>,
			<&hscnoc MASTER_APPSS_PROC QCOM_ICC_TAG_ALWAYS
			 &config_noc SLAVE_QUP_2 QCOM_ICC_TAG_ALWAYS>,
			<&aggre1_noc_tile MASTER_QUP_2 QCOM_ICC_TAG_ALWAYS
			 &mc_virt SLAVE_EBI1 QCOM_ICC_TAG_ALWAYS>;
	interconnect-names = "qup-core", "qup-config", "qup-memory";
	pinctrl-0 = <&qup_i2c14_default>;
	pinctrl-names = "default";
};

&i2c16 {
	clocks = <&negcc NE_GCC_QUPV3_WRAP2_S2_CLK>;
	clock-names = "se";
	interconnects = <&clk_virt MASTER_QUP_CORE_2 QCOM_ICC_TAG_ALWAYS
			 &clk_virt SLAVE_QUP_CORE_2 QCOM_ICC_TAG_ALWAYS>,
			<&hscnoc MASTER_APPSS_PROC QCOM_ICC_TAG_ALWAYS
			 &config_noc SLAVE_QUP_2 QCOM_ICC_TAG_ALWAYS>,
			<&aggre1_noc_tile MASTER_QUP_2 QCOM_ICC_TAG_ALWAYS
			 &mc_virt SLAVE_EBI1 QCOM_ICC_TAG_ALWAYS>;
	interconnect-names = "qup-core", "qup-config", "qup-memory";
	pinctrl-0 = <&qup_i2c16_default>;
	pinctrl-names = "default";
};

&i2c17 {
	clocks = <&negcc NE_GCC_QUPV3_WRAP2_S3_CLK>;
	clock-names = "se";
	interconnects = <&clk_virt MASTER_QUP_CORE_2 QCOM_ICC_TAG_ALWAYS
			 &clk_virt SLAVE_QUP_CORE_2 QCOM_ICC_TAG_ALWAYS>,
			<&hscnoc MASTER_APPSS_PROC QCOM_ICC_TAG_ALWAYS
			 &config_noc SLAVE_QUP_2 QCOM_ICC_TAG_ALWAYS>,
			<&aggre1_noc_tile MASTER_QUP_2 QCOM_ICC_TAG_ALWAYS
			 &mc_virt SLAVE_EBI1 QCOM_ICC_TAG_ALWAYS>;
	interconnect-names = "qup-core", "qup-config", "qup-memory";
	pinctrl-0 = <&qup_i2c17_default>;
	pinctrl-names = "default";
};

&i2c18 {
	clocks = <&negcc NE_GCC_QUPV3_WRAP2_S4_CLK>;
	clock-names = "se";
	interconnects = <&clk_virt MASTER_QUP_CORE_2 QCOM_ICC_TAG_ALWAYS
			 &clk_virt SLAVE_QUP_CORE_2 QCOM_ICC_TAG_ALWAYS>,
			<&hscnoc MASTER_APPSS_PROC QCOM_ICC_TAG_ALWAYS
			 &config_noc SLAVE_QUP_2 QCOM_ICC_TAG_ALWAYS>,
			<&aggre1_noc_tile MASTER_QUP_2 QCOM_ICC_TAG_ALWAYS
			 &mc_virt SLAVE_EBI1 QCOM_ICC_TAG_ALWAYS>;
	interconnect-names = "qup-core", "qup-config", "qup-memory";
	pinctrl-0 = <&qup_i2c18_default>;
	pinctrl-names = "default";
};

&i2c19 {
	clocks = <&negcc NE_GCC_QUPV3_WRAP2_S5_CLK>;
	clock-names = "se";
	interconnects = <&clk_virt MASTER_QUP_CORE_2 QCOM_ICC_TAG_ALWAYS
			 &clk_virt SLAVE_QUP_CORE_2 QCOM_ICC_TAG_ALWAYS>,
			<&hscnoc MASTER_APPSS_PROC QCOM_ICC_TAG_ALWAYS
			 &config_noc SLAVE_QUP_2 QCOM_ICC_TAG_ALWAYS>,
			<&aggre1_noc_tile MASTER_QUP_2 QCOM_ICC_TAG_ALWAYS
			 &mc_virt SLAVE_EBI1 QCOM_ICC_TAG_ALWAYS>;
	interconnect-names = "qup-core", "qup-config", "qup-memory";
	pinctrl-0 = <&qup_i2c19_default>;
	pinctrl-names = "default";
};

&i2c20 {
	clocks = <&negcc NE_GCC_QUPV3_WRAP2_S6_CLK>;
	clock-names = "se";
	interconnects = <&clk_virt MASTER_QUP_CORE_2 QCOM_ICC_TAG_ALWAYS
			 &clk_virt SLAVE_QUP_CORE_2 QCOM_ICC_TAG_ALWAYS>,
			<&hscnoc MASTER_APPSS_PROC QCOM_ICC_TAG_ALWAYS
			 &config_noc SLAVE_QUP_2 QCOM_ICC_TAG_ALWAYS>,
			<&aggre1_noc_tile MASTER_QUP_2 QCOM_ICC_TAG_ALWAYS
			 &mc_virt SLAVE_EBI1 QCOM_ICC_TAG_ALWAYS>;
	interconnect-names = "qup-core", "qup-config", "qup-memory";
	pinctrl-0 = <&qup_i2c20_default>;
	pinctrl-names = "default";
};

&qupv3_0 {
	clocks = <&segcc SE_GCC_QUPV3_WRAP0_M_AHB_CLK>,
		 <&segcc SE_GCC_QUPV3_WRAP0_S_AHB_CLK>;
	clock-names = "m-ahb", "s-ahb";
};

&qupv3_1 {
	clocks = <&segcc SE_GCC_QUPV3_WRAP1_M_AHB_CLK>,
		 <&segcc SE_GCC_QUPV3_WRAP1_S_AHB_CLK>;
	clock-names = "m-ahb", "s-ahb";
};

&qupv3_2 {
	clocks = <&negcc NE_GCC_QUPV3_WRAP2_M_AHB_CLK>,
		 <&negcc NE_GCC_QUPV3_WRAP2_S_AHB_CLK>;
	clock-names = "m-ahb",
		      "s-ahb";
};

&spi0 {
	clocks = <&segcc SE_GCC_QUPV3_WRAP0_S0_CLK>;
	clock-names = "se";
	interconnects = <&clk_virt MASTER_QUP_CORE_0 QCOM_ICC_TAG_ALWAYS
			 &clk_virt SLAVE_QUP_CORE_0 QCOM_ICC_TAG_ALWAYS>,
			<&hscnoc MASTER_APPSS_PROC QCOM_ICC_TAG_ALWAYS
			 &config_noc SLAVE_QUP_0 QCOM_ICC_TAG_ALWAYS>,
			<&aggre2_noc_tile MASTER_QUP_0 QCOM_ICC_TAG_ALWAYS
			 &mc_virt SLAVE_EBI1 QCOM_ICC_TAG_ALWAYS>;
	interconnect-names = "qup-core", "qup-config", "qup-memory";
	pinctrl-0 = <&qup_spi0_default>;
	pinctrl-names = "default";
};

&spi1 {
	clocks = <&segcc SE_GCC_QUPV3_WRAP0_S1_CLK>;
	clock-names = "se";
	interconnects = <&clk_virt MASTER_QUP_CORE_0 QCOM_ICC_TAG_ALWAYS
			 &clk_virt SLAVE_QUP_CORE_0 QCOM_ICC_TAG_ALWAYS>,
			<&hscnoc MASTER_APPSS_PROC QCOM_ICC_TAG_ALWAYS
			 &config_noc SLAVE_QUP_0 QCOM_ICC_TAG_ALWAYS>,
			<&aggre2_noc_tile MASTER_QUP_0 QCOM_ICC_TAG_ALWAYS
			 &mc_virt SLAVE_EBI1 QCOM_ICC_TAG_ALWAYS>;
	interconnect-names = "qup-core", "qup-config", "qup-memory";
	pinctrl-0 = <&qup_spi1_default>;
	pinctrl-names = "default";
};

&spi2 {
	clocks = <&segcc SE_GCC_QUPV3_WRAP0_S2_CLK>;
	clock-names = "se";
	interconnects = <&clk_virt MASTER_QUP_CORE_0 QCOM_ICC_TAG_ALWAYS
			 &clk_virt SLAVE_QUP_CORE_0 QCOM_ICC_TAG_ALWAYS>,
			<&hscnoc MASTER_APPSS_PROC QCOM_ICC_TAG_ALWAYS
			 &config_noc SLAVE_QUP_0 QCOM_ICC_TAG_ALWAYS>,
			<&aggre2_noc_tile MASTER_QUP_0 QCOM_ICC_TAG_ALWAYS
			 &mc_virt SLAVE_EBI1 QCOM_ICC_TAG_ALWAYS>;
	interconnect-names = "qup-core", "qup-config", "qup-memory";
	pinctrl-0 = <&qup_spi2_default>;
	pinctrl-names = "default";
};

&spi3 {
	clocks = <&segcc SE_GCC_QUPV3_WRAP0_S3_CLK>;
	clock-names = "se";
	interconnects = <&clk_virt MASTER_QUP_CORE_0 QCOM_ICC_TAG_ALWAYS
			 &clk_virt SLAVE_QUP_CORE_0 QCOM_ICC_TAG_ALWAYS>,
			<&hscnoc MASTER_APPSS_PROC QCOM_ICC_TAG_ALWAYS
			 &config_noc SLAVE_QUP_0 QCOM_ICC_TAG_ALWAYS>,
			<&aggre2_noc_tile MASTER_QUP_0 QCOM_ICC_TAG_ALWAYS
			 &mc_virt SLAVE_EBI1 QCOM_ICC_TAG_ALWAYS>;
	interconnect-names = "qup-core", "qup-config", "qup-memory";
	pinctrl-0 = <&qup_spi3_default>;
	pinctrl-names = "default";
};

&spi4 {
	clocks = <&segcc SE_GCC_QUPV3_WRAP0_S4_CLK>;
	clock-names = "se";
	interconnects = <&clk_virt MASTER_QUP_CORE_0 QCOM_ICC_TAG_ALWAYS
			 &clk_virt SLAVE_QUP_CORE_0 QCOM_ICC_TAG_ALWAYS>,
			<&hscnoc MASTER_APPSS_PROC QCOM_ICC_TAG_ALWAYS
			 &config_noc SLAVE_QUP_0 QCOM_ICC_TAG_ALWAYS>,
			<&aggre2_noc_tile MASTER_QUP_0 QCOM_ICC_TAG_ALWAYS
			 &mc_virt SLAVE_EBI1 QCOM_ICC_TAG_ALWAYS>;
	interconnect-names = "qup-core", "qup-config", "qup-memory";
	pinctrl-0 = <&qup_spi4_default>;
	pinctrl-names = "default";
};

&spi5 {
	clocks = <&segcc SE_GCC_QUPV3_WRAP0_S5_CLK>;
	clock-names = "se";
	interconnects = <&clk_virt MASTER_QUP_CORE_0 QCOM_ICC_TAG_ALWAYS
			 &clk_virt SLAVE_QUP_CORE_0 QCOM_ICC_TAG_ALWAYS>,
			<&hscnoc MASTER_APPSS_PROC QCOM_ICC_TAG_ALWAYS
			 &config_noc SLAVE_QUP_0 QCOM_ICC_TAG_ALWAYS>,
			<&aggre2_noc_tile MASTER_QUP_0 QCOM_ICC_TAG_ALWAYS
			 &mc_virt SLAVE_EBI1 QCOM_ICC_TAG_ALWAYS>;
	interconnect-names = "qup-core", "qup-config", "qup-memory";
	pinctrl-0 = <&qup_spi5_default>;
	pinctrl-names = "default";
};

&spi7 {
	clocks = <&segcc SE_GCC_QUPV3_WRAP1_S0_CLK>;
	clock-names = "se";
	interconnects = <&clk_virt MASTER_QUP_CORE_1 QCOM_ICC_TAG_ALWAYS
			 &clk_virt SLAVE_QUP_CORE_1 QCOM_ICC_TAG_ALWAYS>,
			<&hscnoc MASTER_APPSS_PROC QCOM_ICC_TAG_ALWAYS
			 &config_noc SLAVE_QUP_1 QCOM_ICC_TAG_ALWAYS>,
			<&aggre2_noc_tile MASTER_QUP_1 QCOM_ICC_TAG_ALWAYS
			 &mc_virt SLAVE_EBI1 QCOM_ICC_TAG_ALWAYS>;
	interconnect-names = "qup-core", "qup-config", "qup-memory";
	pinctrl-0 = <&qup_spi7_default>;
	pinctrl-names = "default";
};

&spi8 {
	clocks = <&segcc SE_GCC_QUPV3_WRAP1_S1_CLK>;
	clock-names = "se";
	interconnects = <&clk_virt MASTER_QUP_CORE_1 QCOM_ICC_TAG_ALWAYS
			 &clk_virt SLAVE_QUP_CORE_1 QCOM_ICC_TAG_ALWAYS>,
			<&hscnoc MASTER_APPSS_PROC QCOM_ICC_TAG_ALWAYS
			 &config_noc SLAVE_QUP_1 QCOM_ICC_TAG_ALWAYS>,
			<&aggre2_noc_tile MASTER_QUP_1 QCOM_ICC_TAG_ALWAYS
			 &mc_virt SLAVE_EBI1 QCOM_ICC_TAG_ALWAYS>;
	interconnect-names = "qup-core", "qup-config", "qup-memory";
	pinctrl-0 = <&qup_spi8_default>;
	pinctrl-names = "default";
};

&spi11 {
	clocks = <&segcc SE_GCC_QUPV3_WRAP1_S4_CLK>;
	clock-names = "se";
	interconnects = <&clk_virt MASTER_QUP_CORE_1 QCOM_ICC_TAG_ALWAYS
			 &clk_virt SLAVE_QUP_CORE_1 QCOM_ICC_TAG_ALWAYS>,
			<&hscnoc MASTER_APPSS_PROC QCOM_ICC_TAG_ALWAYS
			 &config_noc SLAVE_QUP_1 QCOM_ICC_TAG_ALWAYS>,
			<&aggre2_noc_tile MASTER_QUP_1 QCOM_ICC_TAG_ALWAYS
			 &mc_virt SLAVE_EBI1 QCOM_ICC_TAG_ALWAYS>;
	interconnect-names = "qup-core", "qup-config", "qup-memory";
	pinctrl-0 = <&qup_spi11_default>;
	pinctrl-names = "default";
};

&spi12 {
	clocks = <&segcc SE_GCC_QUPV3_WRAP1_S5_CLK>;
	clock-names = "se";
	interconnects = <&clk_virt MASTER_QUP_CORE_1 QCOM_ICC_TAG_ALWAYS
			 &clk_virt SLAVE_QUP_CORE_1 QCOM_ICC_TAG_ALWAYS>,
			<&hscnoc MASTER_APPSS_PROC QCOM_ICC_TAG_ALWAYS
			 &config_noc SLAVE_QUP_1 QCOM_ICC_TAG_ALWAYS>,
			<&aggre2_noc_tile MASTER_QUP_1 QCOM_ICC_TAG_ALWAYS
			 &mc_virt SLAVE_EBI1 QCOM_ICC_TAG_ALWAYS>;
	interconnect-names = "qup-core", "qup-config", "qup-memory";
	pinctrl-0 = <&qup_spi12_default>;
	pinctrl-names = "default";
};

&spi13 {
	clocks = <&segcc SE_GCC_QUPV3_WRAP1_S6_CLK>;
	clock-names = "se";
	interconnects = <&clk_virt MASTER_QUP_CORE_1 QCOM_ICC_TAG_ALWAYS
			 &clk_virt SLAVE_QUP_CORE_1 QCOM_ICC_TAG_ALWAYS>,
			<&hscnoc MASTER_APPSS_PROC QCOM_ICC_TAG_ALWAYS
			 &config_noc SLAVE_QUP_1 QCOM_ICC_TAG_ALWAYS>,
			<&aggre2_noc_tile MASTER_QUP_1 QCOM_ICC_TAG_ALWAYS
			 &mc_virt SLAVE_EBI1 QCOM_ICC_TAG_ALWAYS>;
	interconnect-names = "qup-core", "qup-config", "qup-memory";
	pinctrl-0 = <&qup_spi13_default>;
	pinctrl-names = "default";
};

&spi14 {
	clocks = <&negcc NE_GCC_QUPV3_WRAP2_S0_CLK>;
	clock-names = "se";
	interconnects = <&clk_virt MASTER_QUP_CORE_2 QCOM_ICC_TAG_ALWAYS
			 &clk_virt SLAVE_QUP_CORE_2 QCOM_ICC_TAG_ALWAYS>,
			<&hscnoc MASTER_APPSS_PROC QCOM_ICC_TAG_ALWAYS
			 &config_noc SLAVE_QUP_2 QCOM_ICC_TAG_ALWAYS>,
			<&aggre1_noc_tile MASTER_QUP_2 QCOM_ICC_TAG_ALWAYS
			 &mc_virt SLAVE_EBI1 QCOM_ICC_TAG_ALWAYS>;
	interconnect-names = "qup-core", "qup-config", "qup-memory";
	pinctrl-0 = <&qup_spi14_default>;
	pinctrl-names = "default";
};

&spi16 {
	clocks = <&negcc NE_GCC_QUPV3_WRAP2_S2_CLK>;
	clock-names = "se";
	interconnects = <&clk_virt MASTER_QUP_CORE_2 QCOM_ICC_TAG_ALWAYS
			 &clk_virt SLAVE_QUP_CORE_2 QCOM_ICC_TAG_ALWAYS>,
			<&hscnoc MASTER_APPSS_PROC QCOM_ICC_TAG_ALWAYS
			 &config_noc SLAVE_QUP_2 QCOM_ICC_TAG_ALWAYS>,
			<&aggre1_noc_tile MASTER_QUP_2 QCOM_ICC_TAG_ALWAYS
			 &mc_virt SLAVE_EBI1 QCOM_ICC_TAG_ALWAYS>;
	interconnect-names = "qup-core", "qup-config", "qup-memory";
	pinctrl-0 = <&qup_spi16_default>;
	pinctrl-names = "default";
};

&spi17 {
	clocks = <&negcc NE_GCC_QUPV3_WRAP2_S3_CLK>;
	clock-names = "se";
	interconnects = <&clk_virt MASTER_QUP_CORE_2 QCOM_ICC_TAG_ALWAYS
			 &clk_virt SLAVE_QUP_CORE_2 QCOM_ICC_TAG_ALWAYS>,
			<&hscnoc MASTER_APPSS_PROC QCOM_ICC_TAG_ALWAYS
			 &config_noc SLAVE_QUP_2 QCOM_ICC_TAG_ALWAYS>,
			<&aggre1_noc_tile MASTER_QUP_2 QCOM_ICC_TAG_ALWAYS
			 &mc_virt SLAVE_EBI1 QCOM_ICC_TAG_ALWAYS>;
	interconnect-names = "qup-core", "qup-config", "qup-memory";
	pinctrl-0 = <&qup_spi17_default>;
	pinctrl-names = "default";
};

&spi18 {
	clocks = <&negcc NE_GCC_QUPV3_WRAP2_S4_CLK>;
	clock-names = "se";
	interconnects = <&clk_virt MASTER_QUP_CORE_2 QCOM_ICC_TAG_ALWAYS
			 &clk_virt SLAVE_QUP_CORE_2 QCOM_ICC_TAG_ALWAYS>,
			<&hscnoc MASTER_APPSS_PROC QCOM_ICC_TAG_ALWAYS
			 &config_noc SLAVE_QUP_2 QCOM_ICC_TAG_ALWAYS>,
			<&aggre1_noc_tile MASTER_QUP_2 QCOM_ICC_TAG_ALWAYS
			 &mc_virt SLAVE_EBI1 QCOM_ICC_TAG_ALWAYS>;
	interconnect-names = "qup-core", "qup-config", "qup-memory";
	pinctrl-0 = <&qup_spi18_default>;
	pinctrl-names = "default";
};

&spi19 {
	clocks = <&negcc NE_GCC_QUPV3_WRAP2_S5_CLK>;
	clock-names = "se";
	interconnects = <&clk_virt MASTER_QUP_CORE_2 QCOM_ICC_TAG_ALWAYS
			 &clk_virt SLAVE_QUP_CORE_2 QCOM_ICC_TAG_ALWAYS>,
			<&hscnoc MASTER_APPSS_PROC QCOM_ICC_TAG_ALWAYS
			 &config_noc SLAVE_QUP_2 QCOM_ICC_TAG_ALWAYS>,
			<&aggre1_noc_tile MASTER_QUP_2 QCOM_ICC_TAG_ALWAYS
			 &mc_virt SLAVE_EBI1 QCOM_ICC_TAG_ALWAYS>;
	interconnect-names = "qup-core", "qup-config", "qup-memory";
	pinctrl-0 = <&qup_spi19_default>;
	pinctrl-names = "default";
};

&spi20 {
	clocks = <&negcc NE_GCC_QUPV3_WRAP2_S6_CLK>;
	clock-names = "se";
	interconnects = <&clk_virt MASTER_QUP_CORE_2 QCOM_ICC_TAG_ALWAYS
			 &clk_virt SLAVE_QUP_CORE_2 QCOM_ICC_TAG_ALWAYS>,
			<&hscnoc MASTER_APPSS_PROC QCOM_ICC_TAG_ALWAYS
			 &config_noc SLAVE_QUP_2 QCOM_ICC_TAG_ALWAYS>,
			<&aggre1_noc_tile MASTER_QUP_2 QCOM_ICC_TAG_ALWAYS
			 &mc_virt SLAVE_EBI1 QCOM_ICC_TAG_ALWAYS>;
	interconnect-names = "qup-core", "qup-config", "qup-memory";
	pinctrl-0 = <&qup_spi20_default>;
	pinctrl-names = "default";
};

&soc {
	gcc: clock-controller@100000 {
		compatible = "qcom,nord-gcc";
		reg = <0x0 0x00100000 0x0 0x1f4200>;
		clocks = <&bi_tcxo_div2>,
			 <&sleep_clk>,
			 <0>,
			 <0>,
			 <0>,
			 <0>;
		#clock-cells = <1>;
		#reset-cells = <1>;
		#power-domain-cells = <1>;
	};

	cnoc_main: interconnect@1500000 {
		compatible = "qcom,nord-cnoc-main";
		reg = <0x0 0x01500000 0x0 0x1d200>;
		#interconnect-cells = <2>;
		qcom,bcm-voters = <&apps_bcm_voter>;
	};

	config_noc: interconnect@1600000 {
		compatible = "qcom,nord-cnoc-cfg";
		reg = <0x0 0x01600000 0x0 0xd200>;
		#interconnect-cells = <2>;
		qcom,bcm-voters = <&apps_bcm_voter>;
	};

	system_noc: interconnect@1680000 {
		compatible = "qcom,nord-system-noc";
		reg = <0x0 0x01680000 0x0 0x1c080>;
		#interconnect-cells = <2>;
		qcom,bcm-voters = <&apps_bcm_voter>;
	};

	aggre2_noc_tile: interconnect@16c0000 {
		compatible = "qcom,nord-aggre2-noc-tile";
		reg = <0x0 0x016c0000 0x0 0x1b400>;
		#interconnect-cells = <2>;
		qcom,bcm-voters = <&apps_bcm_voter>;
	};

	aggre1_noc: interconnect@16e0000 {
		compatible = "qcom,nord-aggre1-noc";
		reg = <0x0 0x016e0000 0x0 0x1c400>;
		#interconnect-cells = <2>;
		qcom,bcm-voters = <&apps_bcm_voter>;
	};

	aggre2_noc: interconnect@1700000 {
		compatible = "qcom,nord-aggre2-noc";
		reg = <0x0 0x01700000 0x0 0x1b400>;
		#interconnect-cells = <2>;
		qcom,bcm-voters = <&apps_bcm_voter>;
		clocks = <&rpmhcc RPMH_IPA_CLK>;
	};

	aggre1_noc_tile: interconnect@1720000 {
		compatible = "qcom,nord-aggre1-noc-tile";
		reg = <0x0 0x01720000 0x0 0x23400>;
		#interconnect-cells = <2>;
		qcom,bcm-voters = <&apps_bcm_voter>;
		clocks = <&negcc NE_GCC_AGGRE_NOC_USB2_AXI_CLK>,
			 <&negcc NE_GCC_AGGRE_NOC_USB3_PRIM_AXI_CLK>,
			 <&negcc NE_GCC_AGGRE_NOC_USB3_SEC_AXI_CLK>,
			 <&negcc NE_GCC_AGGRE_NOC_UFS_PHY_AXI_CLK>;
	};

	mmss_noc: interconnect@1780000 {
		compatible = "qcom,nord-mmss-noc";
		reg = <0x0 0x01780000 0x0 0x72800>;
		#interconnect-cells = <2>;
		qcom,bcm-voters = <&apps_bcm_voter>;
	};

	pcie_cfg: interconnect@1ba0000 {
		compatible = "qcom,nord-pcie-cfg";
		reg = <0x0 0x01ba0000 0x0 0x7200>;
		#interconnect-cells = <2>;
		qcom,bcm-voters = <&apps_bcm_voter>;
	};

	pcie_data_outbound: interconnect@1bc0000 {
		compatible = "qcom,nord-pcie-data-outbound";
		reg = <0x0 0x01bc0000 0x0 0x17000>;
		#interconnect-cells = <2>;
		qcom,bcm-voters = <&apps_bcm_voter>;
	};

	pcie_data_inbound: interconnect@1c00000 {
		compatible = "qcom,nord-pcie-data-inbound";
		reg = <0x0 0x01c00000 0x0 0x4b080>;
		#interconnect-cells = <2>;
		qcom,bcm-voters = <&apps_bcm_voter>;
	};

	ufs_mem_phy: phy@1d40000 {
		compatible = "qcom,nord-qmp-ufs-phy",
			     "qcom,sm8650-qmp-ufs-phy";
		reg = <0x0 0x01d40000 0x0 0x2000>;

		clocks = <&rpmhcc RPMH_CXO_CLK>,
			 <&negcc NE_GCC_UFS_PHY_PHY_AUX_CLK>,
			 <&tcsrcc TCSR_UFS_CLKREF_EN>;
		clock-names = "ref",
			      "ref_aux",
			      "qref";

		resets = <&ufs_mem_hc 0>;
		reset-names = "ufsphy";

		power-domains = <&negcc NE_GCC_UFS_MEM_PHY_GDSC>;
		#clock-cells = <1>;
		#phy-cells = <0>;

		status = "disabled";
	};

	ice: crypto@1d48000 {
		compatible = "qcom,nord-inline-crypto-engine",
			     "qcom,inline-crypto-engine";
		reg = <0x0 0x01d48000 0x0 0x10000>;
		clocks = <&negcc NE_GCC_UFS_PHY_ICE_CORE_CLK>,
			 <&negcc NE_GCC_UFS_PHY_AHB_CLK>;
		clock-names = "core",
			      "iface";
		power-domains = <&negcc NE_GCC_UFS_PHY_GDSC>;
	};

	hscnoc: interconnect@2000000 {
		compatible = "qcom,nord-hscnoc";
		reg = <0x0 0x02000000 0x0 0xb22000>;
		#interconnect-cells = <2>;
		qcom,bcm-voters = <&apps_bcm_voter>;
	};

	hpass_ag_noc: interconnect@5fc0000 {
		compatible = "qcom,nord-hpass-ag-noc";
		reg = <0x0  0x05fc0000 0x0 0x37080>;
		#interconnect-cells = <2>;
		qcom,bcm-voters = <&apps_bcm_voter>;
	};

	negcc: clock-controller@8900000 {
		compatible = "qcom,nord-negcc";
		reg = <0x0 0x08900000 0x0 0xf4200>;
		clocks = <&bi_tcxo_div2>,
			 <&sleep_clk>,
			 <0>,
			 <0>,
			 <0>,
			 <0>,
			 <0>;
		#clock-cells = <1>;
		#reset-cells = <1>;
		#power-domain-cells = <1>;
	};

	segcc: clock-controller@8a00000 {
		compatible = "qcom,nord-segcc";
		reg = <0x0 0x08a00000 0x0 0xf4200>;
		clocks = <&bi_tcxo_div2>,
			 <&sleep_clk>;
		#clock-cells = <1>;
		#reset-cells = <1>;
		#power-domain-cells = <1>;
	};

	nwgcc: clock-controller@8b00000 {
		compatible = "qcom,nord-nwgcc";
		reg = <0x0 0x08b00000 0x0 0xf4200>;
		clocks = <&bi_tcxo_div2>,
			 <&sleep_clk>;
		#clock-cells = <1>;
		#reset-cells = <1>;
		#power-domain-cells = <1>;
	};

	tcsrcc: clock-controller@f1d9000 {
		compatible = "qcom,nord-tcsrcc",
			     "syscon";
		reg = <0x0 0x0f1d9000 0x0 0xf00c>;
		clocks = <&rpmhcc RPMH_CXO_CLK>;
		#clock-cells = <1>;
		#reset-cells = <1>;
	};

	gpucc: clock-controller@3d90000 {
		compatible = "qcom,nord-gpucc";
		reg = <0x0 0x03d90000 0x0 0xa000>;
		clocks = <&bi_tcxo_div2>,
			 <&gcc GCC_GPLL0>,
			 <&gcc GCC_GPLL0_OUT_EVEN>;
		#clock-cells = <1>;
		#reset-cells = <1>;
		#power-domain-cells = <1>;
	};

	dispcc: clock-controller@af00000 {
		compatible = "qcom,nord-dispcc";
		reg = <0x0 0x0af00000 0x0 0x20000>;
		clocks = <&bi_tcxo_div2>,
			 <&bi_tcxo_ao_div2>,
			 <&nwgcc NW_GCC_DISP_0_AHB_CLK>,
			 <&sleep_clk>,
			 <0>, <0>,	/* dsi0 byte/pixel phy pll */
			 <0>, <0>,	/* dsi1 byte/pixel phy pll */
			 <&usb_0_qmpphy QMP_USB43DP_DP_LINK_CLK>, <&usb_0_qmpphy QMP_USB43DP_DP_VCO_DIV_CLK>,	/* dp0 link/vco */
			 <0>, <0>,	/* dp1 link/vco phy pll */
			 <&mdss_dp2_phy 0>, <&mdss_dp2_phy 1>,	/* dp2 link/vco */
			 <&mdss_dp3_phy 0>, <&mdss_dp3_phy 1>;	/* dp3 link/vco */
		power-domains = <&rpmhpd RPMHPD_MMCX>;
		required-opps = <&rpmhpd_opp_low_svs>;
		#clock-cells = <1>;
		#reset-cells = <1>;
		#power-domain-cells = <1>;
	};

	mdss: display-subsystem@ae00000 {
		status = "disabled";
		compatible = "qcom,sm8650-mdss";
		reg = <0x0 0x0ae00000 0x0 0x1000>;
		reg-names = "mdss";
		interrupts = <GIC_SPI 930 IRQ_TYPE_LEVEL_HIGH>;
		clocks = <&dispcc DISP_CC_MDSS_AHB_CLK>,
			 <&nwgcc NW_GCC_DISP_0_HF_AXI_CLK>,
			 <&dispcc DISP_CC_MDSS_MDP_CLK>;
		resets = <&dispcc DISP_CC_MDSS_CORE_BCR>;
		/* SID 0x3e0 block on apps_smmu_1 (TCU1); mask 0x20000 covers
		 * the pixel/config tag (0x203e0), per the downstream TZ IORT
		 * DISPLAY_0 node.  The DPU child inherits this mapping. */
		iommus = <&apps_smmu_1 0x3e0 0x20000>;
		interconnects = <&mmss_noc MASTER_MDP0 QCOM_ICC_TAG_ALWAYS
				 &mc_virt SLAVE_EBI1 QCOM_ICC_TAG_ALWAYS>;
		interconnect-names = "mdp0-mem";
		power-domains = <&dispcc MDSS_GDSC>;
		interrupt-controller;
		#interrupt-cells = <1>;
		#address-cells = <2>;
		#size-cells = <2>;
		#clock-cells = <1>;
		ranges;

		mdss_mdp: display-controller@ae01000 {
			compatible = "qcom,x1e80100-dpu";
			reg = <0x0 0x0ae01000 0x0 0x8f000>,
			      <0x0 0x0aeb0000 0x0 0x3000>;
			reg-names = "mdp", "vbif";

			interrupts-extended = <&mdss 0>;

			clocks = <&nwgcc NW_GCC_DISP_0_HF_AXI_CLK>,
				 <&dispcc DISP_CC_MDSS_AHB_CLK>,
				 <&dispcc DISP_CC_MDSS_MDP_LUT_CLK>,
				 <&dispcc DISP_CC_MDSS_MDP_CLK>,
				 <&dispcc DISP_CC_MDSS_VSYNC_CLK>;
			clock-names = "nrt_bus", "iface", "lut", "core", "vsync";

			assigned-clocks = <&dispcc DISP_CC_MDSS_VSYNC_CLK>;
			assigned-clock-rates = <19200000>;

			operating-points-v2 = <&mdp_opp_table>;
			power-domains = <&rpmhpd RPMHPD_MMCX>;

			mdp_opp_table: opp-table {
				compatible = "operating-points-v2";

				opp-200000000 {
					opp-hz = /bits/ 64 <200000000>;
					opp-level = <RPMH_REGULATOR_LEVEL_LOW_SVS>;
				};

				opp-325000000 {
					opp-hz = /bits/ 64 <325000000>;
					opp-level = <RPMH_REGULATOR_LEVEL_SVS>;
				};
			};

			ports {
				#address-cells = <1>;
				#size-cells = <0>;

				/*
				 * x1e80100 DPU catalog INTF map (dpu_9_2_x1e80100.h):
				 * the DPU port reg number is the INTF id, and the DP
				 * controller_id selects the INTF via
				 * dpu_encoder_get_intf(INTF_DP, controller_id):
				 *   INTF_5 -> DP controller 3 (mdss_dp3 @ af6c000)
				 *   INTF_6 -> DP controller 2 (mdss_dp2 @ af64000)
				 * Mirrors upstream sc8280xp.dtsi mdss0 wiring.
				 */
				/* INTF_0 -> DP controller 0 (mdss_dp0 @ af54000), per glymur */
				port@0 {
					reg = <0>;
					dpu_intf0_out: endpoint {
						remote-endpoint = <&mdss_dp0_in>;
					};
				};

				port@5 {
					reg = <5>;
					dpu_intf5_out: endpoint {
						remote-endpoint = <&mdss_dp3_in>;
					};
				};

				port@6 {
					reg = <6>;
					dpu_intf6_out: endpoint {
						remote-endpoint = <&mdss_dp2_in>;
					};
				};
			};
		};

		mdss_dp0: displayport-controller@af54000 {
			compatible = "qcom,glymur-dp";
			reg = <0x0 0x0af54000 0x0 0x200>,
			      <0x0 0x0af54200 0x0 0x200>,
			      <0x0 0x0af55000 0x0 0xc00>,
			      <0x0 0x0af56000 0x0 0x400>,
			      <0x0 0x0af57000 0x0 0x400>,
			      <0x0 0x0af58000 0x0 0x400>,
			      <0x0 0x0af59000 0x0 0x400>,
			      <0x0 0x0af5a000 0x0 0x600>,
			      <0x0 0x0af5b000 0x0 0x600>;
			interrupts-extended = <&mdss 12>;
			clocks = <&dispcc DISP_CC_MDSS_AHB_CLK>,
				 <&dispcc DISP_CC_MDSS_DPTX0_AUX_CLK>,
				 <&dispcc DISP_CC_MDSS_DPTX0_LINK_CLK>,
				 <&dispcc DISP_CC_MDSS_DPTX0_LINK_INTF_CLK>,
				 <&dispcc DISP_CC_MDSS_DPTX0_PIXEL0_CLK>,
				 <&dispcc DISP_CC_MDSS_DPTX0_PIXEL1_CLK>;
			clock-names = "core_iface", "core_aux", "ctrl_link",
				      "ctrl_link_iface", "stream_pixel", "stream_1_pixel";
			assigned-clocks = <&dispcc DISP_CC_MDSS_DPTX0_LINK_CLK_SRC>,
					  <&dispcc DISP_CC_MDSS_DPTX0_PIXEL0_CLK_SRC>,
					  <&dispcc DISP_CC_MDSS_DPTX0_PIXEL1_CLK_SRC>;
			assigned-clock-parents = <&usb_0_qmpphy QMP_USB43DP_DP_LINK_CLK>,
						 <&usb_0_qmpphy QMP_USB43DP_DP_VCO_DIV_CLK>,
						 <&usb_0_qmpphy QMP_USB43DP_DP_VCO_DIV_CLK>;
			phys = <&usb_0_qmpphy QMP_USB43DP_DP_PHY>;
			phy-names = "dp";
			power-domains = <&rpmhpd RPMHPD_MMCX>;
			operating-points-v2 = <&dp0_opp_table>;
			#sound-dai-cells = <0>;

			ports {
				#address-cells = <1>;
				#size-cells = <0>;

				port@0 {
					reg = <0>;
					mdss_dp0_in: endpoint {
						remote-endpoint = <&dpu_intf0_out>;
					};
				};

				port@1 {
					reg = <1>;
					mdss_dp0_out: endpoint {
						remote-endpoint = <&usb_dp_qmpphy_dp_in>;
					};
				};
			};

			dp0_opp_table: opp-table {
				compatible = "operating-points-v2";

				opp-162000000 {
					opp-hz = /bits/ 64 <162000000>;
					opp-level = <RPMH_REGULATOR_LEVEL_LOW_SVS>;
				};
				opp-270000000 {
					opp-hz = /bits/ 64 <270000000>;
					opp-level = <RPMH_REGULATOR_LEVEL_SVS>;
				};
				opp-540000000 {
					opp-hz = /bits/ 64 <540000000>;
					opp-level = <RPMH_REGULATOR_LEVEL_SVS_L1>;
				};
				opp-810000000 {
					opp-hz = /bits/ 64 <810000000>;
					opp-level = <RPMH_REGULATOR_LEVEL_NOM>;
				};
			};
		};

		mdss_dp2: displayport-controller@af64000 {
			compatible = "qcom,glymur-dp";
			reg = <0x0 0x0af64000 0x0 0x200>,
			      <0x0 0x0af64200 0x0 0x200>,
			      <0x0 0x0af65000 0x0 0xc00>,
			      <0x0 0x0af66000 0x0 0x400>,
			      <0x0 0x0af67000 0x0 0x400>;
			interrupts-extended = <&mdss 14>;
			clocks = <&dispcc DISP_CC_MDSS_AHB_CLK>,
				 <&dispcc DISP_CC_MDSS_DPTX2_AUX_CLK>,
				 <&dispcc DISP_CC_MDSS_DPTX2_LINK_CLK>,
				 <&dispcc DISP_CC_MDSS_DPTX2_LINK_INTF_CLK>,
				 <&dispcc DISP_CC_MDSS_DPTX2_PIXEL0_CLK>,
				 <&dispcc DISP_CC_MDSS_DPTX2_PIXEL1_CLK>;
			clock-names = "core_iface", "core_aux", "ctrl_link",
				      "ctrl_link_iface", "stream_pixel", "stream_1_pixel";
			assigned-clocks = <&dispcc DISP_CC_MDSS_DPTX2_LINK_CLK_SRC>,
					  <&dispcc DISP_CC_MDSS_DPTX2_PIXEL0_CLK_SRC>,
					  <&dispcc DISP_CC_MDSS_DPTX2_PIXEL1_CLK_SRC>;
			assigned-clock-parents = <&mdss_dp2_phy 0>,
						 <&mdss_dp2_phy 1>,
						 <&mdss_dp2_phy 1>;
			phys = <&mdss_dp2_phy>;
			phy-names = "dp";
			power-domains = <&dispcc MDSS_INT2_GDSC>;
			operating-points-v2 = <&dp2_opp_table>;
			#sound-dai-cells = <0>;

			ports {
				#address-cells = <1>;
				#size-cells = <0>;

				port@0 {
					reg = <0>;
					mdss_dp2_in: endpoint {
						remote-endpoint = <&dpu_intf6_out>;
					};
				};

				port@1 {
					reg = <1>;
					mdss_dp2_out: endpoint { };
				};
			};

			dp2_opp_table: opp-table {
				compatible = "operating-points-v2";

				opp-162000000 {
					opp-hz = /bits/ 64 <162000000>;
					opp-level = <RPMH_REGULATOR_LEVEL_LOW_SVS>;
				};
				opp-270000000 {
					opp-hz = /bits/ 64 <270000000>;
					opp-level = <RPMH_REGULATOR_LEVEL_SVS>;
				};
				opp-540000000 {
					opp-hz = /bits/ 64 <540000000>;
					opp-level = <RPMH_REGULATOR_LEVEL_SVS_L1>;
				};
				opp-810000000 {
					opp-hz = /bits/ 64 <810000000>;
					opp-level = <RPMH_REGULATOR_LEVEL_NOM>;
				};
			};
		};

		mdss_dp3: displayport-controller@af6c000 {
			compatible = "qcom,glymur-dp";
			reg = <0x0 0x0af6c000 0x0 0x200>,
			      <0x0 0x0af6c200 0x0 0x200>,
			      <0x0 0x0af6d000 0x0 0xc00>,
			      <0x0 0x0af6e000 0x0 0x400>,
			      <0x0 0x0af6f000 0x0 0x400>;
			interrupts-extended = <&mdss 15>;
			clocks = <&dispcc DISP_CC_MDSS_AHB_CLK>,
				 <&dispcc DISP_CC_MDSS_DPTX3_AUX_CLK>,
				 <&dispcc DISP_CC_MDSS_DPTX3_LINK_CLK>,
				 <&dispcc DISP_CC_MDSS_DPTX3_LINK_INTF_CLK>,
				 <&dispcc DISP_CC_MDSS_DPTX3_PIXEL0_CLK>;
			clock-names = "core_iface", "core_aux", "ctrl_link",
				      "ctrl_link_iface", "stream_pixel";
			assigned-clocks = <&dispcc DISP_CC_MDSS_DPTX3_LINK_CLK_SRC>,
					  <&dispcc DISP_CC_MDSS_DPTX3_PIXEL0_CLK_SRC>;
			assigned-clock-parents = <&mdss_dp3_phy 0>,
						 <&mdss_dp3_phy 1>;
			phys = <&mdss_dp3_phy>;
			phy-names = "dp";
			power-domains = <&dispcc MDSS_INT2_GDSC>;
			operating-points-v2 = <&dp3_opp_table>;
			#sound-dai-cells = <0>;

			ports {
				#address-cells = <1>;
				#size-cells = <0>;

				port@0 {
					reg = <0>;
					mdss_dp3_in: endpoint {
						remote-endpoint = <&dpu_intf5_out>;
					};
				};

				port@1 {
					reg = <1>;
					mdss_dp3_out: endpoint { };
				};
			};

			dp3_opp_table: opp-table {
				compatible = "operating-points-v2";

				opp-162000000 {
					opp-hz = /bits/ 64 <162000000>;
					opp-level = <RPMH_REGULATOR_LEVEL_LOW_SVS>;
				};
				opp-270000000 {
					opp-hz = /bits/ 64 <270000000>;
					opp-level = <RPMH_REGULATOR_LEVEL_SVS>;
				};
				opp-540000000 {
					opp-hz = /bits/ 64 <540000000>;
					opp-level = <RPMH_REGULATOR_LEVEL_SVS_L1>;
				};
				opp-810000000 {
					opp-hz = /bits/ 64 <810000000>;
					opp-level = <RPMH_REGULATOR_LEVEL_NOM>;
				};
			};
		};
	};

	/*
	 * USB-0 HS (eUSB2) PHY (m31, standalone: no eUSB2 repeater is
	 * populated on this platform, and the repeater phandle is optional
	 * in phy-qcom-m31-eusb2).  The dwc3 controller will not bind
	 * without a usb2-phy.
	 */
	/*
	 * eUSB2 HS PHY bases per IPcat chip 567 (0x088e0000 AHB2PHY window):
	 * USB2PHY_0 @ 0x088ea000 (usb_0), USB2PHY_1 @ 0x088eb000 (usb_1),
	 * USB2PHY_2 @ 0x088e0000 (usb20s/EUD).  The earlier 0x00fd3000 base
	 * decodes to NOTHING on this chip (same copy-paste family as the
	 * old 0xfd5000 combo-PHY bug): every HS PHY init write landed in a
	 * hole, so nothing ever enumerated at high speed.
	 */
	usb_0_hsphy: phy@88ea000 {
		compatible = "qcom,glymur-m31-eusb2-phy",
			     "qcom,sm8750-m31-eusb2-phy";
		reg = <0x0 0x088ea000 0x0 0x29c>;
		#phy-cells = <0>;

		clocks = <&rpmhcc RPMH_CXO_CLK>;
		clock-names = "ref";

		resets = <&negcc NE_GCC_QUSB2PHY_PRIM_BCR>;

		status = "disabled";
	};

	/*
	 * USB-2 (usb20s) HS PHY - USB2PHY_2 @ 0x088e0000.  Serves the ADP's
	 * JUSB2 Type-A jack through the on-board PTN3222 eUSB2 repeater
	 * (reset = PML GPIO_03 hog; VBUS = PMH GPIO_03 hog).  No dedicated
	 * PHY BCR exists in negcc for this instance - USB20_PRIM_BCR resets
	 * the usb20 subsystem (the dwc3-qcom glue's reset is optional and
	 * omitted on usb_2 to avoid an exclusive-reset conflict).
	 */
	usb_2_hsphy: phy@88e0000 {
		compatible = "qcom,glymur-m31-eusb2-phy",
			     "qcom,sm8750-m31-eusb2-phy";
		reg = <0x0 0x088e0000 0x0 0x29c>;
		#phy-cells = <0>;

		clocks = <&rpmhcc RPMH_CXO_CLK>;
		clock-names = "ref";

		/*
		 * No resets: USB2PHY_2 has no dedicated BCR, and pulsing the
		 * USB20_PRIM subsystem BCR from phy_init resets the DWC3
		 * core mid-probe (xhci then dies "can't setup: -110" - hit
		 * live).  The m31 driver treats the reset as optional.
		 */

		status = "disabled";
	};

	/*
	 * USB-2 DWC3 (usb20s @ 0xa200000, IPcat) - HS-only controller for
	 * the Type-A jack.  IRQ INTIDs from IPcat map 3711: usb20s
	 * ctrl_irq[0]=942, power_event=939 -> GIC_SPI 910/907.  No
	 * assigned-clocks (glymur's HS-only instance runs on RCG defaults).
	 * iommu SID pattern-guessed 0x1480 (usb_0=0x1420, usb_1=0x1460); an
	 * SMMU fault will name the real one.
	 */
	usb_2: usb@a200000 {
		compatible = "qcom,glymur-dwc3", "qcom,snps-dwc3";
		reg = <0x0 0x0a200000 0x0 0xfc100>;

		clocks = <&negcc NE_GCC_CNOC_USB2_AXI_CLK>,
			 <&negcc NE_GCC_USB20_MASTER_CLK>,
			 <&negcc NE_GCC_AGGRE_NOC_USB2_AXI_CLK>,
			 <&negcc NE_GCC_USB20_SLEEP_CLK>,
			 <&negcc NE_GCC_USB20_MOCK_UTMI_CLK>;
		clock-names = "cfg_noc",
			      "core",
			      "iface",
			      "sleep",
			      "mock_utmi";

		assigned-clocks = <&negcc NE_GCC_USB20_MOCK_UTMI_CLK>,
				  <&negcc NE_GCC_USB20_MASTER_CLK>;
		assigned-clock-rates = <19200000>, <120000000>;

		interrupts-extended = <&intc GIC_SPI 910 IRQ_TYPE_LEVEL_HIGH>,
				      <&intc GIC_SPI 907 IRQ_TYPE_LEVEL_HIGH>;
		interrupt-names = "dwc_usb3",
				  "pwr_event";

		power-domains = <&negcc NE_GCC_USB20_PRIM_GDSC>;

		/* No iommus (bring-up): direct DMA + arm-smmu.disable_bypass=0,
		 * same rationale as usb_0 (the 0x1480 SID was copy-paste; dwc3
		 * fans DMA over several real streams). Lets the Type-A host port
		 * enumerate devices. TODO: real SID list/mask from IPcat. */

		interconnects = <&aggre1_noc_tile MASTER_USB2 QCOM_ICC_TAG_ALWAYS
				 &mc_virt SLAVE_EBI1 QCOM_ICC_TAG_ALWAYS>,
				<&hscnoc MASTER_APPSS_PROC QCOM_ICC_TAG_ALWAYS
				 &config_noc SLAVE_USB2 QCOM_ICC_TAG_ALWAYS>;
		interconnect-names = "usb-ddr", "apps-usb";

		phys = <&usb_2_hsphy>;
		phy-names = "usb2-phy";

		dr_mode = "host";
		maximum-speed = "high-speed";

		snps,dis_u2_susphy_quirk;
		snps,dis_enblslpm_quirk;

		status = "disabled";
	};

	/* USB-1 HS (eUSB2) PHY - upstream port of the onboard hub (U13). */
	usb_1_hsphy: phy@88eb000 {
		compatible = "qcom,glymur-m31-eusb2-phy",
			     "qcom,sm8750-m31-eusb2-phy";
		reg = <0x0 0x088eb000 0x0 0x29c>;
		#phy-cells = <0>;

		clocks = <&rpmhcc RPMH_CXO_CLK>;
		clock-names = "ref";

		resets = <&negcc NE_GCC_QUSB2PHY_SEC_BCR>;

		status = "disabled";
	};

	/*
	 * USB-0 DWC3 controller.  Clocks, GDSC and BCR are the negcc
	 * USB31_PRIM equivalents of the glymur GCC_USB30_PRIM_* set (Nord
	 * names the prim controller USB31).  The optional HS/SS phy-wake PDC
	 * interrupts are omitted pending the Nord PDC pin map; only the core
	 * dwc_usb3 and pwr_event SPIs are wired.
	 */
	usb_0: usb@a600000 {
		compatible = "qcom,glymur-dwc3", "qcom,snps-dwc3";
		reg = <0x0 0x0a600000 0x0 0xfc100>;

		clocks = <&negcc NE_GCC_CNOC_USB3_PRIM_AXI_CLK>,
			 <&negcc NE_GCC_USB31_PRIM_MASTER_CLK>,
			 <&negcc NE_GCC_AGGRE_NOC_USB3_PRIM_AXI_CLK>,
			 <&negcc NE_GCC_USB31_PRIM_SLEEP_CLK>,
			 <&negcc NE_GCC_USB31_PRIM_MOCK_UTMI_CLK>;
		clock-names = "cfg_noc",
			      "core",
			      "iface",
			      "sleep",
			      "mock_utmi";

		assigned-clocks = <&negcc NE_GCC_USB31_PRIM_MOCK_UTMI_CLK>,
				  <&negcc NE_GCC_USB31_PRIM_MASTER_CLK>;
		assigned-clock-rates = <19200000>, <200000000>;

		/*
		 * IPcat map 3711, u_usb31_gen2_subsystem_0 (= this a600000
		 * controller; subsystem_1 in the same map is SPI 917/918 which
		 * matches usb_1 above, confirming the mapping): ctrl_irq[0] ->
		 * SYS_apcsQgicSPI[133], power_event -> SPI[130].  The old 140/371
		 * were placeholders never looked up - the dwc3 core IRQ was
		 * registered on a dead line (INTID 172) and fired ZERO times, so
		 * in peripheral mode the gadget saw no reset/SETUP events and never
		 * enumerated (host: descriptor read -110).  Host mode hid this
		 * (xhci uses its own path).
		 */
		interrupts-extended = <&intc GIC_SPI 133 IRQ_TYPE_LEVEL_HIGH>,
				      <&intc GIC_SPI 130 IRQ_TYPE_LEVEL_HIGH>;
		interrupt-names = "dwc_usb3",
				  "pwr_event";

		power-domains = <&negcc NE_GCC_USB31_PRIM_GDSC>;
		resets = <&negcc NE_GCC_USB31_PRIM_BCR>;

		/*
		 * No iommus on purpose (bring-up): the dwc3 gadget DMA fans out
		 * over MANY apps_smmu_0 streams (observed live: 0x14e0, 0x1500,
		 * 0x15c0, ... - not the single 0x1420 the copy-paste declared).
		 * A translating domain covering only some of them left the rest
		 * faulting so the gadget never answered SETUP (host: descriptor
		 * read -110).  With no domain, dwc3 does direct (physical) DMA and
		 * arm-smmu.disable_bypass=0 (cmdline) lets its unknown streams pass
		 * through untranslated - physical==physical, no stream-ID guessing.
		 * TODO proper fix: the exact usb_0 SID list/mask from IPcat.
		 */

		phys = <&usb_0_hsphy>,
		       <&usb_0_qmpphy QMP_USB43DP_USB3_PHY>;
		phy-names = "usb2-phy",
			    "usb3-phy";

		dr_mode = "host";
		maximum-speed = "super-speed";

		snps,hird-threshold = /bits/ 8 <0x0>;
		snps,dis-u1-entry-quirk;
		snps,dis-u2-entry-quirk;
		snps,is-utmi-l1-suspend;
		snps,usb3_lpm_capable;
		snps,has-lpm-erratum;
		tx-fifo-resize;
		snps,dis_u2_susphy_quirk;
		snps,dis_enblslpm_quirk;

		interconnects = <&aggre1_noc_tile MASTER_USB3_0 QCOM_ICC_TAG_ALWAYS
				 &mc_virt SLAVE_EBI1 QCOM_ICC_TAG_ALWAYS>,
				<&hscnoc MASTER_APPSS_PROC QCOM_ICC_TAG_ALWAYS
				 &config_noc SLAVE_USB3_0 QCOM_ICC_TAG_ALWAYS>;
		interconnect-names = "usb-ddr", "apps-usb";

		status = "disabled";
	};

	/*
	 * USB-0 / DP combo QMP PHY.  In DP-only use (no mode-switch /
	 * orientation-switch, no USB-SS endpoint on port@1, DP data-lanes
	 * set on the port@0 endpoint) phy-qcom-qmp-combo runs the PHY in
	 * QMPPHY_MODE_DP_ONLY.
	 */
	usb_0_qmpphy: phy@88e1000 {
		/*
		 * USB3_DP_PHY_0. Nord's combo PHY is the sm8550-generation IP
		 * (v3 register offsets: com 0x0, usb3 serdes/tx/rx 0x1000+,
		 * dp_serdes 0x2000, dp_dp_phy 0x2a00), NOT glymur (which uses
		 * the v8 usb43dp layout with tx at 0x4000). The earlier
		 * glymur compatible + base 0xfd5000 was a copy-paste that does
		 * not exist in the Nord memory map (IPcat chip 567: 0xfd5000
		 * decodes to nothing; 0x088e1000 = USB3_DP_PHY_0_USB3_DP_COM),
		 * so every PHY init write landed in a hole and DP AUX stayed
		 * dead (0-byte EDID). PHY_1 begins at 0x088e4000, so the
		 * window is 0x3000.
		 */
		compatible = "qcom,sm8550-qmp-usb3-dp-phy";
		reg = <0x0 0x088e1000 0x0 0x3000>;
		/*
		 * cfg_ahb = ne_gcc_ahb2phy_clk: the AHB2PHY bridge clock for
		 * the 0x088e0000 CSR window. Without it every QMP register
		 * read returns 0x01010101 fill (block dark) - the open stack
		 * does not get it enabled by XBL the way stock does.
		 */
		clocks = <&negcc NE_GCC_USB3_PRIM_PHY_AUX_CLK>,
			 <&negcc NE_GCC_AHB2PHY_CLK>,
			 <&rpmhcc RPMH_CXO_CLK>,
			 <&negcc NE_GCC_USB3_PRIM_PHY_COM_AUX_CLK>,
			 <&negcc NE_GCC_USB3_PRIM_PHY_PIPE_CLK>;
		clock-names = "aux", "cfg_ahb", "ref", "com_aux", "usb3_pipe";
		resets = <&negcc NE_GCC_USB3_PHY_PRIM_BCR>,
			 <&negcc NE_GCC_USB3PHY_PHY_PRIM_BCR>;
		reset-names = "phy", "common";
		power-domains = <&negcc NE_GCC_USB3_PHY_GDSC>;
		#clock-cells = <1>;
		#phy-cells = <1>;
		status = "disabled";

		ports {
			#address-cells = <1>;
			#size-cells = <0>;

			port@0 {
				reg = <0>;
				usb_0_qmpphy_out: endpoint {
				};
			};

			port@2 {
				reg = <2>;
				usb_dp_qmpphy_dp_in: endpoint {
					remote-endpoint = <&mdss_dp0_out>;
				};
			};
		};
	};

	/*
	 * USB3_DP_PHY_1 @ 0x088e4000 (per the PHY_0 comment above: PHY_1
	 * begins at 0x088e4000, window 0x3000).  Serves usb_1, whose SS
	 * lanes go to the onboard USB hub's upstream port (schematic p58:
	 * U13 upstream = SOC_USB1_SS_*).  DP side unused.
	 */
	usb_1_qmpphy: phy@88e4000 {
		compatible = "qcom,sm8550-qmp-usb3-dp-phy";
		reg = <0x0 0x088e4000 0x0 0x3000>;
		clocks = <&negcc NE_GCC_USB3_SEC_PHY_AUX_CLK>,
			 <&negcc NE_GCC_AHB2PHY_CLK>,
			 <&rpmhcc RPMH_CXO_CLK>,
			 <&negcc NE_GCC_USB3_SEC_PHY_COM_AUX_CLK>,
			 <&negcc NE_GCC_USB3_SEC_PHY_PIPE_CLK>;
		clock-names = "aux", "cfg_ahb", "ref", "com_aux", "usb3_pipe";
		resets = <&negcc NE_GCC_USB3_PHY_SEC_BCR>,
			 <&negcc NE_GCC_USB3PHY_PHY_SEC_BCR>;
		reset-names = "phy", "common";
		power-domains = <&negcc NE_GCC_USB3_SEC_PHY_GDSC>;
		#clock-cells = <1>;
		#phy-cells = <1>;
		status = "disabled";

		/*
		 * USB3-only, fixed normal orientation (no CC controller
		 * driving a mode/orientation switch yet).  Without this the
		 * driver cannot determine mode, the pipe clock never runs,
		 * and the dwc3 core soft reset times out (hit live).
		 */
		ports {
			#address-cells = <1>;
			#size-cells = <0>;

			port@0 {
				#address-cells = <1>;
				#size-cells = <0>;
				reg = <0>;

				endpoint@1 {
					reg = <1>;
					/* Must be <1 0>: this driver's static-mode logic only
					 * derives USB3_ONLY from a *reverse* orientation; <0 1>
					 * parses as "no orientation" -> "unable to determine
					 * orientation & mode". Real lane routing is set by
					 * TYPEC_CTRL, not this. */
					data-lanes = <1 0>;
				};
			};
		};
	};

	/*
	 * USB-1 DWC3 controller @ 0x0a400000 (IPcat USB3_1_USB31_GEN2
	 * subsystem).  negcc USB31_SEC clock/GDSC/BCR set.  IRQ INTIDs from
	 * IPcat map 3711: subsystem_1 ctrl_irq[0]=949, power_event=950 ->
	 * GIC_SPI 917/918.  iommu SID 0x1460 modeled on glymur usb_1 (an
	 * SMMU fault will name the real SID if this is wrong).
	 */
	usb_1: usb@a400000 {
		compatible = "qcom,glymur-dwc3", "qcom,snps-dwc3";
		reg = <0x0 0x0a400000 0x0 0xfc100>;

		clocks = <&negcc NE_GCC_CNOC_USB3_SEC_AXI_CLK>,
			 <&negcc NE_GCC_USB31_SEC_MASTER_CLK>,
			 <&negcc NE_GCC_AGGRE_NOC_USB3_SEC_AXI_CLK>,
			 <&negcc NE_GCC_USB31_SEC_SLEEP_CLK>,
			 <&negcc NE_GCC_USB31_SEC_MOCK_UTMI_CLK>;
		clock-names = "cfg_noc",
			      "core",
			      "iface",
			      "sleep",
			      "mock_utmi";

		assigned-clocks = <&negcc NE_GCC_USB31_SEC_MOCK_UTMI_CLK>,
				  <&negcc NE_GCC_USB31_SEC_MASTER_CLK>;
		assigned-clock-rates = <19200000>, <200000000>;

		interrupts-extended = <&intc GIC_SPI 917 IRQ_TYPE_LEVEL_HIGH>,
				      <&intc GIC_SPI 918 IRQ_TYPE_LEVEL_HIGH>;
		interrupt-names = "dwc_usb3",
				  "pwr_event";

		power-domains = <&negcc NE_GCC_USB31_SEC_GDSC>;
		resets = <&negcc NE_GCC_USB31_SEC_BCR>;

		/* No iommus (bring-up): direct DMA + arm-smmu.disable_bypass=0,
		 * same rationale as usb_0 (the 0x1460 SID was copy-paste). Lets
		 * usb_1's onboard hub (U13) + its JUSB1/JUSB2 downstream ports
		 * enumerate. TODO: real SID list/mask from IPcat. */

		/*
		 * Without the apps-usb config-noc vote the USB3_1 CSR path
		 * never opens and dwc3 core init dies -ETIMEDOUT (hit live:
		 * GDSC + clocks verified good, first probe attempt timed
		 * out with these absent).
		 */
		interconnects = <&aggre1_noc_tile MASTER_USB3_1 QCOM_ICC_TAG_ALWAYS
				 &mc_virt SLAVE_EBI1 QCOM_ICC_TAG_ALWAYS>,
				<&hscnoc MASTER_APPSS_PROC QCOM_ICC_TAG_ALWAYS
				 &config_noc SLAVE_USB3_1 QCOM_ICC_TAG_ALWAYS>;
		interconnect-names = "usb-ddr", "apps-usb";

		phys = <&usb_1_hsphy>,
		       <&usb_1_qmpphy QMP_USB43DP_USB3_PHY>;
		phy-names = "usb2-phy",
			    "usb3-phy";

		dr_mode = "host";
		maximum-speed = "super-speed";

		snps,hird-threshold = /bits/ 8 <0x0>;
		snps,dis-u1-entry-quirk;
		snps,dis-u2-entry-quirk;
		snps,is-utmi-l1-suspend;
		snps,usb3_lpm_capable;
		snps,has-lpm-erratum;
		tx-fifo-resize;
		snps,dis_u2_susphy_quirk;
		snps,dis_enblslpm_quirk;

		status = "disabled";
	};

	mdss_dp2_phy: phy@aec2a00 {
		status = "disabled";
		compatible = "qcom,glymur-dp-phy";
		reg = <0x0 0x0aec2a00 0x0 0x19c>,
		      <0x0 0x0aec2200 0x0 0xec>,
		      <0x0 0x0aec2600 0x0 0xec>,
		      <0x0 0x0aec2000 0x0 0x1c8>;
		clocks = <&dispcc DISP_CC_MDSS_DPTX2_AUX_CLK>,
			 <&dispcc DISP_CC_MDSS_AHB_CLK>;
		clock-names = "aux", "cfg_ahb";
		power-domains = <&rpmhpd RPMHPD_MX>;
		#clock-cells = <1>;
		#phy-cells = <0>;
	};

	/*
	 * DP3 dedicated DisplayPort PHY (no USB3 combo, no USB30 GDSC -> no
	 * RPMh dependency).  Reg sub-block bases verified against the Nord
	 * (Pakala) SoC HWIO HWIO_AHB2EDPPHY_DP3_PHY_* in
	 * QcomPkg/SocPkg/Pakala/Tools/hwio/scripts/hwio.cmm:
	 *   EDP_PHY    (DP_PHY) @ 0xaec5a00  (mirrors DP2 @ 0xaec2a00)
	 *   LANE_TX0            @ 0xaec5200
	 *   LANE_TX1            @ 0xaec5600
	 *   QSERDES_COM (PLL)   @ 0xaec5000
	 * vdda-phy/vdda-pll deliberately left unwired: the only available
	 * supplies are RPMh-backed (pmm8654au-rpmh-regulators), and wiring
	 * them would reintroduce the RPMh dependency this display path avoids.
	 * The PHY falls back to the dummy regulator (non-fatal, as on DP2).
	 */
	mdss_dp3_phy: phy@aec5a00 {
		status = "disabled";
		compatible = "qcom,glymur-dp-phy";
		reg = <0x0 0x0aec5a00 0x0 0x19c>,
		      <0x0 0x0aec5200 0x0 0xec>,
		      <0x0 0x0aec5600 0x0 0xec>,
		      <0x0 0x0aec5000 0x0 0x1c8>;
		clocks = <&dispcc DISP_CC_MDSS_DPTX3_AUX_CLK>,
			 <&dispcc DISP_CC_MDSS_AHB_CLK>;
		clock-names = "aux", "cfg_ahb";
		power-domains = <&rpmhpd RPMHPD_MX>;
		#clock-cells = <1>;
		#phy-cells = <0>;
	};

	adreno_smmu: iommu@3da0000 {
		compatible = "qcom,nord-smmu-500", "qcom,adreno-smmu",
			     "qcom,smmu-500", "arm,mmu-500";
		reg = <0x0 0x03da0000 0x0 0x40000>;
		#iommu-cells = <2>;
		#global-interrupts = <1>;
		/* one global interrupt plus one context interrupt per context
		 * bank; the SMMU implements 25 context banks */
		interrupts = <GIC_SPI 673 IRQ_TYPE_LEVEL_HIGH>,
			     <GIC_SPI 674 IRQ_TYPE_LEVEL_HIGH>,
			     <GIC_SPI 675 IRQ_TYPE_LEVEL_HIGH>,
			     <GIC_SPI 676 IRQ_TYPE_LEVEL_HIGH>,
			     <GIC_SPI 677 IRQ_TYPE_LEVEL_HIGH>,
			     <GIC_SPI 678 IRQ_TYPE_LEVEL_HIGH>,
			     <GIC_SPI 679 IRQ_TYPE_LEVEL_HIGH>,
			     <GIC_SPI 680 IRQ_TYPE_LEVEL_HIGH>,
			     <GIC_SPI 681 IRQ_TYPE_LEVEL_HIGH>,
			     <GIC_SPI 682 IRQ_TYPE_LEVEL_HIGH>,
			     <GIC_SPI 683 IRQ_TYPE_LEVEL_HIGH>,
			     <GIC_SPI 684 IRQ_TYPE_LEVEL_HIGH>,
			     <GIC_SPI 685 IRQ_TYPE_LEVEL_HIGH>,
			     <GIC_SPI 686 IRQ_TYPE_LEVEL_HIGH>,
			     <GIC_SPI 687 IRQ_TYPE_LEVEL_HIGH>,
			     <GIC_SPI 688 IRQ_TYPE_LEVEL_HIGH>,
			     <GIC_SPI 689 IRQ_TYPE_LEVEL_HIGH>,
			     <GIC_SPI 690 IRQ_TYPE_LEVEL_HIGH>,
			     <GIC_SPI 691 IRQ_TYPE_LEVEL_HIGH>,
			     <GIC_SPI 692 IRQ_TYPE_LEVEL_HIGH>,
			     <GIC_SPI 693 IRQ_TYPE_LEVEL_HIGH>,
			     <GIC_SPI 694 IRQ_TYPE_LEVEL_HIGH>,
			     <GIC_SPI 695 IRQ_TYPE_LEVEL_HIGH>,
			     <GIC_SPI 696 IRQ_TYPE_LEVEL_HIGH>,
			     <GIC_SPI 697 IRQ_TYPE_LEVEL_HIGH>,
			     <GIC_SPI 698 IRQ_TYPE_LEVEL_HIGH>;
		clocks = <&gpucc GPU_CC_HLOS1_VOTE_GPU_SMMU_CLK>,
			 <&gpucc GPU_CC_AHB_CLK>;
		clock-names = "hlos", "ahb";
		power-domains = <&gpucc GPU_CX_GDSC>;
		dma-coherent;
	};

	gpu: gpu@3d00000 {
		/*
		 * Nord GPU_0: Adreno C314 (ADRENO_7XX_GEN2, gen71500 fw).
		 * chip_id taken from the catalog GEN2 entry; the GMU reports the
		 * exact value into GMU_GENERAL_9 at boot. First-light without a
		 * (device-signed) zap shader: zap-shader node intentionally omitted.
		 */
		compatible = "qcom,adreno-43030c00", "qcom,adreno";
		reg = <0x0 0x03d00000 0x0 0x40000>,
		      <0x0 0x03d9e000 0x0 0x2000>,
		      <0x0 0x03d61000 0x0 0x800>;
		reg-names = "kgsl_3d0_reg_memory", "cx_mem", "cx_dbgc";

		interrupts = <GIC_SPI 300 IRQ_TYPE_LEVEL_HIGH>;

		iommus = <&adreno_smmu 0 0x0>,
			 <&adreno_smmu 1 0x0>;

		operating-points-v2 = <&gpu_opp_table>;

		qcom,gmu = <&gmu>;
		#cooling-cells = <2>;

		status = "okay";

		gpu_opp_table: opp-table {
			compatible = "operating-points-v2-adreno",
				     "operating-points-v2";

			opp-231000000 {
				opp-hz = /bits/ 64 <231000000>;
				opp-level = <RPMH_REGULATOR_LEVEL_LOW_SVS_D1>;
			};

			opp-366000000 {
				opp-hz = /bits/ 64 <366000000>;
				opp-level = <RPMH_REGULATOR_LEVEL_LOW_SVS>;
			};

			opp-500000000 {
				opp-hz = /bits/ 64 <500000000>;
				opp-level = <RPMH_REGULATOR_LEVEL_SVS>;
			};
		};
	};

	gmu: gmu@3d6a000 {
		compatible = "qcom,adreno-gmu-743.0", "qcom,adreno-gmu";
		reg = <0x0 0x03d6a000 0x0 0x35000>,
		      <0x0 0x03d50000 0x0 0x10000>,
		      <0x0 0x0b2a0000 0x0 0x10000>;
		reg-names = "gmu", "rscc", "gmu_pdc";

		interrupts = <GIC_SPI 304 IRQ_TYPE_LEVEL_HIGH>,
			     <GIC_SPI 305 IRQ_TYPE_LEVEL_HIGH>;
		interrupt-names = "hfi", "gmu";

		clocks = <&gpucc GPU_CC_AHB_CLK>,
			 <&gpucc GPU_CC_CX_GMU_CLK>,
			 <&gpucc GPU_CC_CXO_CLK>,
			 <&gpucc GPU_CC_HUB_CX_INT_CLK>,
			 <&gpucc GPU_CC_DEMET_CLK>,
			 <&gpucc GPU_CC_MEMNOC_GFX_CLK>;
		clock-names = "ahb", "gmu", "cxo", "hub", "demet", "memnoc";

		power-domains = <&gpucc GPU_CX_GDSC>,
				<&gpucc GPU_GX_GDSC>;
		power-domain-names = "cx", "gx";

		iommus = <&adreno_smmu 5 0x0>;

		operating-points-v2 = <&gmu_opp_table>;

		gmu_opp_table: opp-table {
			compatible = "operating-points-v2";

			opp-260000000 {
				opp-hz = /bits/ 64 <260000000>;
				opp-level = <RPMH_REGULATOR_LEVEL_LOW_SVS>;
			};

			opp-625000000 {
				opp-hz = /bits/ 64 <625000000>;
				opp-level = <RPMH_REGULATOR_LEVEL_SVS>;
			};
		};
	};

	apps_rsc: rsc@18900000 {
		compatible = "qcom,rpmh-rsc";
		reg = <0x0 0x18900000 0x0 0x10000>,
		      <0x0 0x18910000 0x0 0x10000>,
		      <0x0 0x18920000 0x0 0x10000>;
		reg-names = "drv-0",
			    "drv-1",
			    "drv-2";
		interrupts = <GIC_SPI 27 IRQ_TYPE_LEVEL_HIGH>,
			     <GIC_SPI 28 IRQ_TYPE_LEVEL_HIGH>,
			     <GIC_SPI 29 IRQ_TYPE_LEVEL_HIGH>;
		qcom,tcs-offset = <0xd00>;
		qcom,drv-id = <2>;
		qcom,tcs-config = <ACTIVE_TCS 3>,
				  <SLEEP_TCS 2>,
				  <WAKE_TCS 2>,
				  <CONTROL_TCS 0>;
		label = "apps_rsc";
		power-domains = <&system_pd>;

		apps_bcm_voter: bcm-voter {
			compatible = "qcom,bcm-voter";
		};

		rpmhcc: clock-controller {
			compatible = "qcom,nord-rpmh-clk";
			clocks = <&xo_board>;
			clock-names = "xo";
			#clock-cells = <1>;
		};

		rpmhpd: power-controller {
			compatible = "qcom,nord-rpmhpd";
			#power-domain-cells = <1>;
			operating-points-v2 = <&rpmhpd_opp_table>;

			rpmhpd_opp_table: opp-table {
				compatible = "operating-points-v2";

				rpmhpd_opp_ret: opp-0 {
					opp-level = <RPMH_REGULATOR_LEVEL_RETENTION>;
				};

				rpmhpd_opp_min_svs: opp-1 {
					opp-level = <RPMH_REGULATOR_LEVEL_MIN_SVS>;
				};

				rpmhpd_opp_low_svs: opp2 {
					opp-level = <RPMH_REGULATOR_LEVEL_LOW_SVS>;
				};

				rpmhpd_opp_svs: opp3 {
					opp-level = <RPMH_REGULATOR_LEVEL_SVS>;
				};

				rpmhpd_opp_svs_l1: opp-4 {
					opp-level = <RPMH_REGULATOR_LEVEL_SVS_L1>;
				};

				rpmhpd_opp_nom: opp-5 {
					opp-level = <RPMH_REGULATOR_LEVEL_NOM>;
				};

				rpmhpd_opp_nom_l1: opp-6 {
					opp-level = <RPMH_REGULATOR_LEVEL_NOM_L1>;
				};

				rpmhpd_opp_nom_l2: opp-7 {
					opp-level = <RPMH_REGULATOR_LEVEL_NOM_L2>;
				};

				rpmhpd_opp_turbo: opp-8 {
					opp-level = <RPMH_REGULATOR_LEVEL_TURBO>;
				};

				rpmhpd_opp_turbo_l1: opp-9 {
					opp-level = <RPMH_REGULATOR_LEVEL_TURBO_L1>;
				};
			};
		};
	};

	nsp_data_noc_0: interconnect@1f200000 {
		compatible = "qcom,nord-nsp-data-noc-0";
		reg = <0x0 0x1f200000 0x0 0x2a200>;
		#interconnect-cells = <2>;
		qcom,bcm-voters = <&apps_bcm_voter>;
	};

	nsp_data_noc_1: interconnect@1f600000 {
		compatible = "qcom,nord-nsp-data-noc-1";
		reg = <0x0 0x1f600000 0x0 0x2a200>;
		#interconnect-cells = <2>;
		qcom,bcm-voters = <&apps_bcm_voter>;
	};

	nsp_data_noc_2: interconnect@1fa00000 {
		compatible = "qcom,nord-nsp-data-noc-2";
		reg = <0x0 0x1fa00000 0x0 0x2a200>;
		#interconnect-cells = <2>;
		qcom,bcm-voters = <&apps_bcm_voter>;
	};

	nsp_data_noc_3: interconnect@1fe00000 {
		compatible = "qcom,nord-nsp-data-noc-3";
		reg = <0x0 0x1fe00000 0x0 0x2a200>;
		#interconnect-cells = <2>;
		qcom,bcm-voters = <&apps_bcm_voter>;
	};
};

&tlmm {
	qup_i2c0_default: qup-i2c0-default-state {
		pins = "gpio111", "gpio112";
		function = "qup0_se0";
		drive-strength = <2>;
		bias-pull-up;
	};

	qup_i2c1_default: qup-i2c1-default-state {
		pins = "gpio111", "gpio112";
		function = "qup0_se1";
		drive-strength = <2>;
		bias-pull-up;
	};

	qup_i2c2_default: qup-i2c2-default-state {
		pins = "gpio113", "gpio114";
		function = "qup0_se2";
		drive-strength = <2>;
		bias-pull-up;
	};

	qup_i2c3_default: qup-i2c3-default-state {
		pins = "gpio115", "gpio116";
		function = "qup0_se3";
		drive-strength = <2>;
		bias-pull-up;
	};

	qup_i2c4_default: qup-i2c4-default-state {
		pins = "gpio117", "gpio118";
		function = "qup0_se4";
		drive-strength = <2>;
		bias-pull-up;
	};

	qup_i2c5_default: qup-i2c5-default-state {
		pins = "gpio121", "gpio122";
		function = "qup0_se5";
		drive-strength = <2>;
		bias-pull-up;
	};

	qup_i2c7_default: qup-i2c7-default-state {
		pins = "gpio123", "gpio124";
		function = "qup1_se0";
		drive-strength = <2>;
		bias-pull-up;
	};

	qup_i2c8_default: qup-i2c8-default-state {
		pins = "gpio125", "gpio126";
		function = "qup1_se1";
		drive-strength = <2>;
		bias-pull-up;
	};

	qup_i2c9_default: qup-i2c9-default-state {
		pins = "gpio127", "gpio128";
		function = "qup1_se2";
		drive-strength = <2>;
		bias-pull-up;
	};

	qup_i2c10_default: qup-i2c10-default-state {
		pins = "gpio129", "gpio130";
		function = "qup1_se3";
		drive-strength = <2>;
		bias-pull-up;
	};

	qup_i2c11_default: qup-i2c11-default-state {
		pins = "gpio131", "gpio132";
		function = "qup1_se4";
		drive-strength = <2>;
		bias-pull-up;
	};

	qup_i2c12_default: qup-i2c12-default-state {
		pins = "gpio133", "gpio134";
		function = "qup1_se5";
		drive-strength = <2>;
		bias-pull-up;
	};

	qup_i2c13_default: qup-i2c13-default-state {
		pins = "gpio137", "gpio138";
		function = "qup1_se6";
		drive-strength = <2>;
		bias-pull-up;
	};

	qup_i2c14_default: qup-i2c14-default-state {
		pins = "gpio139", "gpio140";
		function = "qup2_se0";
		drive-strength = <2>;
		bias-pull-up;
	};

	qup_i2c16_default: qup-i2c16-default-state {
		pins = "gpio145", "gpio146";
		function = "qup2_se2";
		drive-strength = <2>;
		bias-pull-up;
	};

	qup_i2c17_default: qup-i2c17-default-state {
		pins = "gpio150", "gpio151";
		function = "qup2_se3";
		drive-strength = <2>;
		bias-pull-up;
	};

	qup_i2c18_default: qup-i2c18-default-state {
		pins = "gpio154", "gpio155";
		function = "qup2_se4";
		drive-strength = <2>;
		bias-pull-up;
	};

	qup_i2c19_default: qup-i2c19-default-state {
		pins = "gpio156", "gpio157";
		function = "qup2_se5";
		drive-strength = <2>;
		bias-pull-up;
	};

	qup_i2c20_default: qup-i2c20-default-state {
		pins = "gpio158", "gpio159";
		function = "qup2_se6";
		drive-strength = <2>;
		bias-pull-up;
	};

	qup_spi0_default: qup-spi0-default-state {
		data-pins {
			pins = "gpio109", "gpio111", "gpio112";
			function = "qup0_se0";
			drive-strength = <6>;
			bias-disable;
		};

		cs-pins {
			pins = "gpio110";
			function = "qup0_se0";
			drive-strength = <2>;
			bias-disable;
		};
	};

	qup_spi1_default: qup-spi1-default-state {
		data-pins {
			pins = "gpio109", "gpio111", "gpio112";
			function = "qup0_se1";
			drive-strength = <6>;
			bias-disable;
		};

		cs-pins {
			pins = "gpio110";
			function = "qup0_se1";
			drive-strength = <2>;
			bias-disable;
		};
	};

	qup_spi2_default: qup-spi2-default-state {
		data-pins {
			pins = "gpio113", "gpio114", "gpio115";
			function = "qup0_se2";
			drive-strength = <6>;
			bias-disable;
		};

		cs-pins {
			pins = "gpio116";
			function = "qup0_se2";
			drive-strength = <2>;
			bias-disable;
		};
	};

	qup_spi3_default: qup-spi3-default-state {
		data-pins {
			pins = "gpio113", "gpio115", "gpio116";
			function = "qup0_se3";
			drive-strength = <6>;
			bias-disable;
		};

		cs-pins {
			pins = "gpio114";
			function = "qup0_se3";
			drive-strength = <2>;
			bias-disable;
		};
	};

	qup_spi4_default: qup-spi4-default-state {
		data-pins {
			pins = "gpio117", "gpio118", "gpio119";
			function = "qup0_se4";
			drive-strength = <6>;
			bias-disable;
		};

		cs-pins {
			pins = "gpio120";
			function = "qup0_se4";
			drive-strength = <2>;
			bias-disable;
		};
	};

	qup_spi5_default: qup-spi5-default-state {
		data-pins {
			pins = "gpio109", "gpio121", "gpio122";
			function = "qup0_se5";
			drive-strength = <6>;
			bias-disable;
		};

		cs-pins {
			pins = "gpio110";
			function = "qup0_se5";
			drive-strength = <2>;
			bias-disable;
		};
	};

	qup_spi7_default: qup-spi7-default-state {
		data-pins {
			pins = "gpio123", "gpio124", "gpio125";
			function = "qup1_se0";
			drive-strength = <6>;
			bias-disable;
		};

		cs-pins {
			pins = "gpio126";
			function = "qup1_se0";
			drive-strength = <2>;
			bias-disable;
		};
	};

	qup_spi8_default: qup-spi8-default-state {
		data-pins {
			pins = "gpio123", "gpio125", "gpio126";
			function = "qup1_se1";
			drive-strength = <6>;
			bias-disable;
		};

		cs-pins {
			pins = "gpio124";
			function = "qup1_se1";
			drive-strength = <2>;
			bias-disable;
		};
	};

	qup_spi11_default: qup-spi11-default-state {
		data-pins {
			pins = "gpio131", "gpio132", "gpio137";
			function = "qup1_se4";
			drive-strength = <6>;
			bias-disable;
		};

		cs-pins {
			pins = "gpio138";
			function = "qup1_se4";
			drive-strength = <2>;
			bias-disable;
		};
	};

	qup_spi12_default: qup-spi12-default-state {
		data-pins {
			pins = "gpio133", "gpio134", "gpio135";
			function = "qup1_se5";
			drive-strength = <6>;
			bias-disable;
		};

		cs-pins {
			pins = "gpio136";
			function = "qup1_se5";
			drive-strength = <2>;
			bias-disable;
		};
	};

	qup_spi13_default: qup-spi13-default-state {
		data-pins {
			pins = "gpio131", "gpio137", "gpio138";
			function = "qup1_se6";
			drive-strength = <6>;
			bias-disable;
		};

		cs-pins {
			pins = "gpio132";
			function = "qup1_se6";
			drive-strength = <2>;
			bias-disable;
		};
	};

	qup_spi14_default: qup-spi14-default-state {
		data-pins {
			pins = "gpio139", "gpio140", "gpio141";
			function = "qup2_se0";
			drive-strength = <6>;
			bias-disable;
		};

		cs-pins {
			pins = "gpio142";
			function = "qup2_se0";
			drive-strength = <2>;
			bias-disable;
		};
	};

	qup_spi16_default: qup-spi16-default-state {
		data-pins {
			pins = "gpio145", "gpio146", "gpio147";
			function = "qup2_se2";
			drive-strength = <6>;
			bias-disable;
		};

		cs-pins {
			pins = "gpio148";
			function = "qup2_se2";
			drive-strength = <2>;
			bias-disable;
		};
	};

	qup_spi17_default: qup-spi17-default-state {
		data-pins {
			pins = "gpio150", "gpio151", "gpio152";
			function = "qup2_se3";
			drive-strength = <6>;
			bias-disable;
		};

		cs-pins {
			pins = "gpio153";
			function = "qup2_se3";
			drive-strength = <2>;
			bias-disable;
		};
	};

	qup_spi18_default: qup-spi18-default-state {
		data-pins {
			pins = "gpio143", "gpio154", "gpio155";
			function = "qup2_se4";
			drive-strength = <6>;
			bias-disable;
		};

		cs-pins {
			pins = "gpio144";
			function = "qup2_se4";
			drive-strength = <2>;
			bias-disable;
		};
	};

	qup_spi19_default: qup-spi19-default-state {
		data-pins {
			pins = "gpio156", "gpio157", "gpio158";
			function = "qup2_se5";
			drive-strength = <6>;
			bias-disable;
		};

		cs-pins {
			pins = "gpio159";
			function = "qup2_se5";
			drive-strength = <2>;
			bias-disable;
		};
	};

	qup_spi20_default: qup-spi20-default-state {
		data-pins {
			pins = "gpio156", "gpio158", "gpio159";
			function = "qup2_se6";
			drive-strength = <6>;
			bias-disable;
		};

		cs-pins {
			pins = "gpio157";
			function = "qup2_se6";
			drive-strength = <2>;
			bias-disable;
		};
	};

	qup_uart0_default: qup-uart0-default-state {
		pins = "gpio109", "gpio110";
		function = "qup0_se0";
		drive-strength = <2>;
		bias-disable;
	};

	qup_uart1_default: qup-uart1-default-state {
		pins = "gpio109", "gpio110";
		function = "qup0_se1";
		drive-strength = <2>;
		bias-disable;
	};

	qup_uart2_default: qup-uart2-default-state {
		pins = "gpio115", "gpio116";
		function = "qup0_se2";
		drive-strength = <2>;
		bias-disable;
	};

	qup_uart3_default: qup-uart3-default-state {
		pins = "gpio113", "gpio114";
		function = "qup0_se3";
		drive-strength = <2>;
		bias-disable;
	};

	qup_uart4_default: qup-uart4-default-state {
		pins = "gpio119", "gpio120";
		function = "qup0_se4";
		drive-strength = <2>;
		bias-disable;
	};

	qup_uart5_default: qup-uart5-default-state {
		pins = "gpio109", "gpio110";
		function = "qup0_se5";
		drive-strength = <2>;
		bias-disable;
	};

	qup_uart7_default: qup-uart7-default-state {
		pins = "gpio125", "gpio126";
		function = "qup1_se0";
		drive-strength = <2>;
		bias-disable;
	};

	qup_uart8_default: qup-uart8-default-state {
		pins = "gpio123", "gpio124";
		function = "qup1_se1";
		drive-strength = <2>;
		bias-disable;
	};

	qup_uart9_default: qup-uart9-default-state {
		pins = "gpio127", "gpio128";
		function = "qup1_se2";
		drive-strength = <2>;
		bias-disable;
	};

	qup_uart10_default: qup-uart10-default-state {
		pins = "gpio129", "gpio130";
		function = "qup1_se3";
		drive-strength = <2>;
		bias-disable;
	};

	qup_uart11_default: qup-uart11-default-state {
		pins = "gpio137", "gpio138";
		function = "qup1_se4";
		drive-strength = <2>;
		bias-disable;
	};

	qup_uart12_default: qup-uart12-default-state {
		pins = "gpio135", "gpio136";
		function = "qup1_se5";
		drive-strength = <2>;
		bias-disable;
	};

	qup_uart13_default: qup-uart13-default-state {
		pins = "gpio131", "gpio132";
		function = "qup1_se6";
		drive-strength = <2>;
		bias-disable;
	};

	qup_uart14_default: qup-uart14-default-state {
		pins = "gpio141", "gpio142";
		function = "qup2_se0";
		drive-strength = <2>;
		bias-disable;
	};

	qup_uart15_default: qup-uart15-default-state {
		pins = "gpio143", "gpio144";
		function = "qup2_se1";
		drive-strength = <2>;
		bias-disable;
	};

	qup_uart16_default: qup-uart16-default-state {
		pins = "gpio147", "gpio148";
		function = "qup2_se2";
		drive-strength = <2>;
		bias-disable;
	};

	qup_uart17_default: qup-uart17-default-state {
		pins = "gpio152", "gpio153";
		function = "qup2_se3";
		drive-strength = <2>;
		bias-disable;
	};

	qup_uart18_default: qup-uart18-default-state {
		pins = "gpio143", "gpio144";
		function = "qup2_se4";
		drive-strength = <2>;
		bias-disable;
	};

	qup_uart19_default: qup-uart19-default-state {
		pins = "gpio158", "gpio159";
		function = "qup2_se5";
		drive-strength = <2>;
		bias-disable;
	};

	qup_uart20_default: qup-uart20-default-state {
		pins = "gpio156", "gpio157";
		function = "qup2_se6";
		drive-strength = <2>;
		bias-disable;
	};

	/*
	 * DisplayPort hot-plug-detect pads.  The msm DP driver does HPD
	 * with the controller's internal HPD register block plus its own
	 * platform IRQ; it consumes no hpd-gpios and binds no pinctrl
	 * itself.  These states only mux the TLMM pad to the SoC HPD
	 * function so the internal HPD block sees the sink edge - the
	 * driver-core "default" pinctrl applies them at probe.  Mapping
	 * from the Nord XBL pinctrl.dtsi:
	 *   DP2 (af64000) HPD = GPIO51 func edp0_hot (downstream eDP0)
	 *   DP3 (af6c000) HPD = GPIO52 func edp1_hot (downstream eDP1)
	 */
	dp2_hpd_default: dp2-hpd-default-state {
		pins = "gpio51";
		function = "edp0_hot";
		bias-disable;
	};

	dp3_hpd_default: dp3-hpd-default-state {
		pins = "gpio52";
		function = "edp1_hot";
		bias-disable;
	};
};

&uart0 {
	clocks = <&negcc SE_GCC_QUPV3_WRAP0_S0_CLK>;
	clock-names = "se";
	interconnects = <&clk_virt MASTER_QUP_CORE_0 QCOM_ICC_TAG_ALWAYS
			 &clk_virt SLAVE_QUP_CORE_0 QCOM_ICC_TAG_ALWAYS>,
			<&hscnoc MASTER_APPSS_PROC QCOM_ICC_TAG_ALWAYS
			 &config_noc SLAVE_QUP_0 QCOM_ICC_TAG_ALWAYS>;
	interconnect-names = "qup-core", "qup-config";
	pinctrl-0 = <&qup_uart0_default>;
	pinctrl-names = "default";
};

&uart1 {
	clocks = <&negcc SE_GCC_QUPV3_WRAP0_S1_CLK>;
	clock-names = "se";
	interconnects = <&clk_virt MASTER_QUP_CORE_0 QCOM_ICC_TAG_ALWAYS
			 &clk_virt SLAVE_QUP_CORE_0 QCOM_ICC_TAG_ALWAYS>,
			<&hscnoc MASTER_APPSS_PROC QCOM_ICC_TAG_ALWAYS
			 &config_noc SLAVE_QUP_0 QCOM_ICC_TAG_ALWAYS>;
	interconnect-names = "qup-core", "qup-config";
	pinctrl-0 = <&qup_uart1_default>;
	pinctrl-names = "default";
};

&uart2 {
	clocks = <&negcc SE_GCC_QUPV3_WRAP0_S2_CLK>;
	clock-names = "se";
	interconnects = <&clk_virt MASTER_QUP_CORE_0 QCOM_ICC_TAG_ALWAYS
			 &clk_virt SLAVE_QUP_CORE_0 QCOM_ICC_TAG_ALWAYS>,
			<&hscnoc MASTER_APPSS_PROC QCOM_ICC_TAG_ALWAYS
			 &config_noc SLAVE_QUP_0 QCOM_ICC_TAG_ALWAYS>;
	interconnect-names = "qup-core", "qup-config";
	pinctrl-0 = <&qup_uart2_default>;
	pinctrl-names = "default";
};

&uart3 {
	clocks = <&negcc SE_GCC_QUPV3_WRAP0_S3_CLK>;
	clock-names = "se";
	interconnects = <&clk_virt MASTER_QUP_CORE_0 QCOM_ICC_TAG_ALWAYS
			 &clk_virt SLAVE_QUP_CORE_0 QCOM_ICC_TAG_ALWAYS>,
			<&hscnoc MASTER_APPSS_PROC QCOM_ICC_TAG_ALWAYS
			 &config_noc SLAVE_QUP_0 QCOM_ICC_TAG_ALWAYS>;
	interconnect-names = "qup-core", "qup-config";
	pinctrl-0 = <&qup_uart3_default>;
	pinctrl-names = "default";
};

&uart4 {
	clocks = <&negcc SE_GCC_QUPV3_WRAP0_S4_CLK>;
	clock-names = "se";
	interconnects = <&clk_virt MASTER_QUP_CORE_0 QCOM_ICC_TAG_ALWAYS
			 &clk_virt SLAVE_QUP_CORE_0 QCOM_ICC_TAG_ALWAYS>,
			<&hscnoc MASTER_APPSS_PROC QCOM_ICC_TAG_ALWAYS
			 &config_noc SLAVE_QUP_0 QCOM_ICC_TAG_ALWAYS>;
	interconnect-names = "qup-core", "qup-config";
	pinctrl-0 = <&qup_uart4_default>;
	pinctrl-names = "default";
};

&uart5 {
	clocks = <&negcc SE_GCC_QUPV3_WRAP0_S5_CLK>;
	clock-names = "se";
	interconnects = <&clk_virt MASTER_QUP_CORE_0 QCOM_ICC_TAG_ALWAYS
			 &clk_virt SLAVE_QUP_CORE_0 QCOM_ICC_TAG_ALWAYS>,
			<&hscnoc MASTER_APPSS_PROC QCOM_ICC_TAG_ALWAYS
			 &config_noc SLAVE_QUP_0 QCOM_ICC_TAG_ALWAYS>;
	interconnect-names = "qup-core", "qup-config";
	pinctrl-0 = <&qup_uart5_default>;
	pinctrl-names = "default";
};

&uart7 {
	clocks = <&negcc SE_GCC_QUPV3_WRAP1_S0_CLK>;
	clock-names = "se";
	interconnects = <&clk_virt MASTER_QUP_CORE_1 QCOM_ICC_TAG_ALWAYS
			 &clk_virt SLAVE_QUP_CORE_1 QCOM_ICC_TAG_ALWAYS>,
			<&hscnoc MASTER_APPSS_PROC QCOM_ICC_TAG_ALWAYS
			 &config_noc SLAVE_QUP_1 QCOM_ICC_TAG_ALWAYS>;
	interconnect-names = "qup-core", "qup-config";
	pinctrl-0 = <&qup_uart7_default>;
	pinctrl-names = "default";
};

&uart8 {
	clocks = <&negcc SE_GCC_QUPV3_WRAP1_S1_CLK>;
	clock-names = "se";
	interconnects = <&clk_virt MASTER_QUP_CORE_1 QCOM_ICC_TAG_ALWAYS
			 &clk_virt SLAVE_QUP_CORE_1 QCOM_ICC_TAG_ALWAYS>,
			<&hscnoc MASTER_APPSS_PROC QCOM_ICC_TAG_ALWAYS
			 &config_noc SLAVE_QUP_1 QCOM_ICC_TAG_ALWAYS>;
	interconnect-names = "qup-core", "qup-config";
	pinctrl-0 = <&qup_uart8_default>;
	pinctrl-names = "default";
};

&uart9 {
	clocks = <&negcc SE_GCC_QUPV3_WRAP1_S2_CLK>;
	clock-names = "se";
	interconnects = <&clk_virt MASTER_QUP_CORE_1 QCOM_ICC_TAG_ALWAYS
			 &clk_virt SLAVE_QUP_CORE_1 QCOM_ICC_TAG_ALWAYS>,
			<&hscnoc MASTER_APPSS_PROC QCOM_ICC_TAG_ALWAYS
			 &config_noc SLAVE_QUP_1 QCOM_ICC_TAG_ALWAYS>;
	interconnect-names = "qup-core", "qup-config";
	pinctrl-0 = <&qup_uart9_default>;
	pinctrl-names = "default";
};

&uart10 {
	clocks = <&negcc SE_GCC_QUPV3_WRAP1_S3_CLK>;
	clock-names = "se";
	interconnects = <&clk_virt MASTER_QUP_CORE_1 QCOM_ICC_TAG_ALWAYS
			 &clk_virt SLAVE_QUP_CORE_1 QCOM_ICC_TAG_ALWAYS>,
			<&hscnoc MASTER_APPSS_PROC QCOM_ICC_TAG_ALWAYS
			 &config_noc SLAVE_QUP_1 QCOM_ICC_TAG_ALWAYS>;
	interconnect-names = "qup-core", "qup-config";
	pinctrl-0 = <&qup_uart10_default>;
	pinctrl-names = "default";
};

&uart11 {
	clocks = <&negcc SE_GCC_QUPV3_WRAP1_S4_CLK>;
	clock-names = "se";
	interconnects = <&clk_virt MASTER_QUP_CORE_1 QCOM_ICC_TAG_ALWAYS
			 &clk_virt SLAVE_QUP_CORE_1 QCOM_ICC_TAG_ALWAYS>,
			<&hscnoc MASTER_APPSS_PROC QCOM_ICC_TAG_ALWAYS
			 &config_noc SLAVE_QUP_1 QCOM_ICC_TAG_ALWAYS>;
	interconnect-names = "qup-core", "qup-config";
	pinctrl-0 = <&qup_uart11_default>;
	pinctrl-names = "default";
};

&uart12 {
	clocks = <&negcc SE_GCC_QUPV3_WRAP1_S5_CLK>;
	clock-names = "se";
	interconnects = <&clk_virt MASTER_QUP_CORE_1 QCOM_ICC_TAG_ALWAYS
			 &clk_virt SLAVE_QUP_CORE_1 QCOM_ICC_TAG_ALWAYS>,
			<&hscnoc MASTER_APPSS_PROC QCOM_ICC_TAG_ALWAYS
			 &config_noc SLAVE_QUP_1 QCOM_ICC_TAG_ALWAYS>;
	interconnect-names = "qup-core", "qup-config";
	pinctrl-0 = <&qup_uart12_default>;
	pinctrl-names = "default";
};

&uart13 {
	clocks = <&negcc SE_GCC_QUPV3_WRAP1_S6_CLK>;
	clock-names = "se";
	interconnects = <&clk_virt MASTER_QUP_CORE_1 QCOM_ICC_TAG_ALWAYS
			 &clk_virt SLAVE_QUP_CORE_1 QCOM_ICC_TAG_ALWAYS>,
			<&hscnoc MASTER_APPSS_PROC QCOM_ICC_TAG_ALWAYS
			 &config_noc SLAVE_QUP_1 QCOM_ICC_TAG_ALWAYS>;
	interconnect-names = "qup-core", "qup-config";
	pinctrl-0 = <&qup_uart13_default>;
	pinctrl-names = "default";
};

&uart14 {
	clocks = <&negcc NE_GCC_QUPV3_WRAP2_S0_CLK>;
	clock-names = "se";
	interconnects = <&clk_virt MASTER_QUP_CORE_2 QCOM_ICC_TAG_ALWAYS
			 &clk_virt SLAVE_QUP_CORE_2 QCOM_ICC_TAG_ALWAYS>,
			<&hscnoc MASTER_APPSS_PROC QCOM_ICC_TAG_ALWAYS
			 &config_noc SLAVE_QUP_2 QCOM_ICC_TAG_ALWAYS>;
	interconnect-names = "qup-core", "qup-config";
	pinctrl-0 = <&qup_uart14_default>;
	pinctrl-names = "default";
};

&uart15 {
	clocks = <&negcc NE_GCC_QUPV3_WRAP2_S1_CLK>;
	clock-names = "se";
	interconnects = <&clk_virt MASTER_QUP_CORE_2 QCOM_ICC_TAG_ALWAYS
			 &clk_virt SLAVE_QUP_CORE_2 QCOM_ICC_TAG_ALWAYS>,
			<&hscnoc MASTER_APPSS_PROC QCOM_ICC_TAG_ALWAYS
			 &config_noc SLAVE_QUP_2 QCOM_ICC_TAG_ALWAYS>;
	interconnect-names = "qup-core", "qup-config";
	pinctrl-0 = <&qup_uart15_default>;
	pinctrl-names = "default";
};

&uart16 {
	clocks = <&negcc NE_GCC_QUPV3_WRAP2_S2_CLK>;
	clock-names = "se";
	interconnects = <&clk_virt MASTER_QUP_CORE_2 QCOM_ICC_TAG_ALWAYS
			 &clk_virt SLAVE_QUP_CORE_2 QCOM_ICC_TAG_ALWAYS>,
			<&hscnoc MASTER_APPSS_PROC QCOM_ICC_TAG_ALWAYS
			 &config_noc SLAVE_QUP_2 QCOM_ICC_TAG_ALWAYS>;
	interconnect-names = "qup-core", "qup-config";
	pinctrl-0 = <&qup_uart16_default>;
	pinctrl-names = "default";
};

&uart17 {
	clocks = <&negcc NE_GCC_QUPV3_WRAP2_S3_CLK>;
	clock-names = "se";
	interconnects = <&clk_virt MASTER_QUP_CORE_2 QCOM_ICC_TAG_ALWAYS
			 &clk_virt SLAVE_QUP_CORE_2 QCOM_ICC_TAG_ALWAYS>,
			<&hscnoc MASTER_APPSS_PROC QCOM_ICC_TAG_ALWAYS
			 &config_noc SLAVE_QUP_2 QCOM_ICC_TAG_ALWAYS>;
	interconnect-names = "qup-core", "qup-config";
	pinctrl-0 = <&qup_uart17_default>;
	pinctrl-names = "default";
};

&uart18 {
	clocks = <&negcc NE_GCC_QUPV3_WRAP2_S4_CLK>;
	clock-names = "se";
	interconnects = <&clk_virt MASTER_QUP_CORE_2 QCOM_ICC_TAG_ALWAYS
			 &clk_virt SLAVE_QUP_CORE_2 QCOM_ICC_TAG_ALWAYS>,
			<&hscnoc MASTER_APPSS_PROC QCOM_ICC_TAG_ALWAYS
			 &config_noc SLAVE_QUP_2 QCOM_ICC_TAG_ALWAYS>;
	interconnect-names = "qup-core", "qup-config";
	pinctrl-0 = <&qup_uart18_default>;
	pinctrl-names = "default";
};

&uart19 {
	clocks = <&negcc NE_GCC_QUPV3_WRAP2_S5_CLK>;
	clock-names = "se";
	interconnects = <&clk_virt MASTER_QUP_CORE_2 QCOM_ICC_TAG_ALWAYS
			 &clk_virt SLAVE_QUP_CORE_2 QCOM_ICC_TAG_ALWAYS>,
			<&hscnoc MASTER_APPSS_PROC QCOM_ICC_TAG_ALWAYS
			 &config_noc SLAVE_QUP_2 QCOM_ICC_TAG_ALWAYS>;
	interconnect-names = "qup-core", "qup-config";
	pinctrl-0 = <&qup_uart19_default>;
	pinctrl-names = "default";
};

&uart20 {
	clocks = <&negcc NE_GCC_QUPV3_WRAP2_S6_CLK>;
	clock-names = "se";
	interconnects = <&clk_virt MASTER_QUP_CORE_2 QCOM_ICC_TAG_ALWAYS
			 &clk_virt SLAVE_QUP_CORE_2 QCOM_ICC_TAG_ALWAYS>,
			<&hscnoc MASTER_APPSS_PROC QCOM_ICC_TAG_ALWAYS
			 &config_noc SLAVE_QUP_2 QCOM_ICC_TAG_ALWAYS>;
	interconnect-names = "qup-core", "qup-config";
	pinctrl-0 = <&qup_uart20_default>;
	pinctrl-names = "default";
};

&ufs_mem_hc {
	reg = <0x0 0x01d44000 0x0 0x3000>,
	      <0x0 0x01d60000 0x0 0x15000>;
	reg-names = "std",
		    "mcq";

	clocks = <&negcc NE_GCC_UFS_PHY_AXI_CLK>,
		 <&negcc NE_GCC_AGGRE_NOC_UFS_PHY_AXI_CLK>,
		 <&negcc NE_GCC_UFS_PHY_AHB_CLK>,
		 <&negcc NE_GCC_UFS_PHY_UNIPRO_CORE_CLK>,
		 <&tcsrcc TCSR_UFS_CLKREF_EN>,
		 <&negcc NE_GCC_UFS_PHY_TX_SYMBOL_0_CLK>,
		 <&negcc NE_GCC_UFS_PHY_RX_SYMBOL_0_CLK>,
		 <&negcc NE_GCC_UFS_PHY_RX_SYMBOL_1_CLK>;
	clock-names = "core_clk",
		      "bus_aggr_clk",
		      "iface_clk",
		      "core_clk_unipro",
		      "ref_clk",
		      "tx_lane0_sync_clk",
		      "rx_lane0_sync_clk",
		      "rx_lane1_sync_clk";

	resets = <&negcc NE_GCC_UFS_PHY_BCR>;
	reset-names = "rst";

	interconnects = <&aggre1_noc_tile MASTER_UFS_MEM QCOM_ICC_TAG_ALWAYS
			 &mc_virt SLAVE_EBI1 QCOM_ICC_TAG_ALWAYS>,
			<&hscnoc MASTER_APPSS_PROC QCOM_ICC_TAG_ACTIVE_ONLY
			 &config_noc SLAVE_UFS_MEM_CFG QCOM_ICC_TAG_ACTIVE_ONLY>;
	interconnect-names = "ufs-ddr",
			     "cpu-ufs";

	phys = <&ufs_mem_phy>;
	phy-names = "ufsphy";

	power-domains = <&negcc NE_GCC_UFS_PHY_GDSC>;
	operating-points-v2 = <&ufs_opp_table>;
	required-opps = <&rpmhpd_opp_nom>;
	qcom,ice = <&ice>;
	#reset-cells = <1>;

	status = "disabled";

	ufs_opp_table: opp-table {
		compatible = "operating-points-v2";

		opp-100000000 {
			opp-hz = /bits/ 64 <100000000>,
				 /bits/ 64 <0>,
				 /bits/ 64 <0>,
				 /bits/ 64 <100000000>,
				 /bits/ 64 <0>,
				 /bits/ 64 <0>,
				 /bits/ 64 <0>,
				 /bits/ 64 <0>;
			required-opps = <&rpmhpd_opp_low_svs>;
		};

		opp-201500000 {
			opp-hz = /bits/ 64 <201500000>,
				 /bits/ 64 <0>,
				 /bits/ 64 <0>,
				 /bits/ 64 <201500000>,
				 /bits/ 64 <0>,
				 /bits/ 64 <0>,
				 /bits/ 64 <0>,
				 /bits/ 64 <0>;
			required-opps = <&rpmhpd_opp_svs>;
		};

		opp-403000000 {
			opp-hz = /bits/ 64 <403000000>,
				 /bits/ 64 <0>,
				 /bits/ 64 <0>,
				 /bits/ 64 <403000000>,
				 /bits/ 64 <0>,
				 /bits/ 64 <0>,
				 /bits/ 64 <0>,
				 /bits/ 64 <0>;
			required-opps = <&rpmhpd_opp_nom>;
		};
	};
};
