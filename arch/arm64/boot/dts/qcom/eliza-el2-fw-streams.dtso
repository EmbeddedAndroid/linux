// SPDX-License-Identifier: BSD-3-Clause
/*
 * Copyright (c) Qualcomm Technologies, Inc. and/or its subsidiaries.
 *
 * Remote processor firmware streams mapped by Linux when it runs in EL2.
 * Left out when the secure firmware maps them itself.
 */

/dts-v1/;
/plugin/;

/* Stream of the iris core's own firmware fetches, mapped by Gunyah at EL1 */
&iris {
	video-firmware {
		iommus = <&apps_smmu 0x1942 0x0>;
	};
};

&remoteproc_adsp {
	iommus = <&apps_smmu 0x1000 0x0>,
		 <&apps_smmu 0x100c 0x0>;
};

&remoteproc_cdsp {
	iommus = <&apps_smmu 0x0c00 0x0>;
};
