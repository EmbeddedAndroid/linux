## Documentation/devicetree/bindings/media/i2c/himax,hm1092.yaml
```yaml
# SPDX-License-Identifier: (GPL-2.0-only OR BSD-2-Clause)
%YAML 1.2
---
$id: http://devicetree.org/schemas/media/i2c/himax,hm1092.yaml#
$schema: http://devicetree.org/meta-schemas/core.yaml#

title: Himax HM1092 Near-Infrared Image Sensor

description:
  The Himax HM1092 is a monochrome near-infrared image sensor used for face
  authentication cameras. It is controlled over I2C and transmits 10-bit
  RAW data over a single-lane MIPI CSI-2 D-PHY interface.

maintainers:
  - Tyler Baker <forcedinductionz@gmail.com>

allOf:
  - $ref: /schemas/media/video-interface-devices.yaml#

properties:
  compatible:
    const: himax,hm1092

  reg:
    maxItems: 1

  clocks:
    description: MCLK input clock.
    maxItems: 1

  reset-gpios:
    description: Active low GPIO connected to the reset pad of the sensor.
    maxItems: 1

  avdd-supply:
    description: Analogue voltage supply, 2.8 volts.

  dovdd-supply:
    description: Digital I/O voltage supply, 1.8 volts.

  dvdd-supply:
    description: Digital core voltage supply.

  port:
    $ref: /schemas/graph.yaml#/$defs/port-base
    additionalProperties: false

    properties:
      endpoint:
        $ref: /schemas/media/video-interfaces.yaml#
        unevaluatedProperties: false

        properties:
          data-lanes:
            items:
              - const: 1

        required:
          - data-lanes
          - link-frequencies

required:
  - compatible
  - reg
  - clocks
  - avdd-supply
  - dovdd-supply
  - port

unevaluatedProperties: false

examples:
  - |
    #include <dt-bindings/gpio/gpio.h>

    i2c {
        #address-cells = <1>;
        #size-cells = <0>;

        camera@24 {
            compatible = "himax,hm1092";
            reg = <0x24>;
            clocks = <&camera_clk 0>;
            assigned-clocks = <&camera_clk 0>;
            assigned-clock-rates = <19200000>;
            reset-gpios = <&tlmm 109 GPIO_ACTIVE_LOW>;
            avdd-supply = <&vreg_2p8>;
            dovdd-supply = <&vreg_1p8>;

            port {
                endpoint {
                    data-lanes = <1>;
                    link-frequencies = /bits/ 64 <180480000>;
                    remote-endpoint = <&csiphy_ep>;
                };
            };
        };
    };
...
```
