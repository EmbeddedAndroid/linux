## Documentation/devicetree/bindings/ufs/qcom,sa8255p-ufshc.yaml
```yaml
# SPDX-License-Identifier: GPL-2.0-only OR BSD-2-Clause
%YAML 1.2
---
$id: http://devicetree.org/schemas/ufs/qcom,sa8255p-ufshc.yaml#
$schema: http://devicetree.org/meta-schemas/core.yaml#

title: Qualcomm SA8255P UFS Host Controller

maintainers:
  - Ram Kumar Dwivedi <ram.dwivedi@oss.qualcomm.com>

properties:
  compatible:
    oneOf:
      - const: qcom,sa8255p-ufshc
      - items:
          - const: qcom,sa8797p-ufshc
          - const: qcom,sa8255p-ufshc
      - items:
          - const: qcom,secaau-ufshc
          - const: qcom,sa8255p-ufshc

  reg:
    minItems: 1
    maxItems: 2

  reg-names:
    minItems: 1
    items:
      - const: std
      - const: mcq

  interrupts:
    maxItems: 1

  iommus:
    maxItems: 1

  dma-coherent: true

  power-domains:
    minItems: 1
    items:
      - description: UFS host controller and PHY power domain
      - description: Firmware power domain the high-speed link depends on
          while the host is active

  power-domain-names:
    minItems: 1
    items:
      - const: power
      - const: s2r

required:
  - compatible
  - reg
  - interrupts
  - power-domains
  - iommus
  - dma-coherent

allOf:
  - $ref: ufs-common.yaml
  - if:
      properties:
        compatible:
          contains:
            const: qcom,secaau-ufshc
    then:
      properties:
        power-domains:
          minItems: 2
        power-domain-names:
          minItems: 2
      required:
        - power-domain-names
    else:
      properties:
        power-domains:
          maxItems: 1
        power-domain-names:
          maxItems: 1

unevaluatedProperties: false

examples:
  - |
    #include <dt-bindings/interrupt-controller/arm-gic.h>

    ufshc@1d84000 {
        compatible = "qcom,sa8255p-ufshc";
        reg = <0x01d84000 0x3000>;
        interrupts = <GIC_SPI 265 IRQ_TYPE_LEVEL_HIGH>;
        lanes-per-direction = <2>;

        iommus = <&apps_smmu 0x100 0x0>;
        power-domains = <&scmi3_pd 0>;
        dma-coherent;
    };
```

## drivers/accel/qda/Kconfig
```kconfig
# SPDX-License-Identifier: GPL-2.0-only
#
# Qualcomm DSP accelerator driver
#

config DRM_ACCEL_QDA
	tristate "Qualcomm DSP accelerator"
	depends on DRM_ACCEL
	depends on ARCH_QCOM || COMPILE_TEST
	depends on RPMSG
	select AUXILIARY_BUS
	select QCOM_SCM
	help
	  Enables the DRM-based accelerator driver for Qualcomm's Hexagon DSPs.
	  This driver provides a standardized interface for offloading computational
	  tasks to the DSP, including audio processing, sensor offload, computer
	  vision, and AI inference workloads.

	  The driver supports all DSP domains (ADSP, CDSP, SDSP, GDSP) and
	  implements the FastRPC protocol for communication between the application
	  processor and DSP. It integrates with the Linux kernel's Compute
	  Accelerators subsystem (drivers/accel/) and is intended to replace the
	  FastRPC driver in drivers/misc/. Both drivers bind the same device tree
	  nodes, so only one of them can be built.

	  If unsure, say N.

	  To compile this driver as a module, choose M here: the
	  module will be called qda.

config DRM_ACCEL_QDA_FASTRPC_SHIM
	tristate "Qualcomm DSP accelerator legacy FastRPC compatibility shim"
	depends on DRM_ACCEL_QDA
	default DRM_ACCEL_QDA
	help
	  Exposes a /dev/fastrpc-<dsp> character device per DSP domain, serving
	  the ioctl interface of the FastRPC driver in drivers/misc/ on top of
	  the QDA driver, so that existing FastRPC user space keeps working.

	  This is a compatibility layer for user space that has not moved to
	  the native interface in include/uapi/drm/qda_accel.h; new users
	  should use that instead.

	  To compile this driver as a module, choose M here: the
	  module will be called qda_fastrpc_shim.
```
