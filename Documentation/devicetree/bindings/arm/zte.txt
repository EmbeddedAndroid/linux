## Documentation/devicetree/bindings/arm/zte.txt
```
ZTE platforms device tree bindings
---------------------------------------

-  ZX296702 board:
    Required root node properties:
      - compatible = "zte,zx296702-ad1", "zte,zx296702"

Low power management required properties:
      - compatible = "zte,aon-sysctrl"
```

## arch/arm/mach-zx/Kconfig
```kconfig
config ARCH_ZX
	bool "ZTE ZX family" if ARCH_MULTI_V7
	help
	  Support for ZTE ZX-based family of processors. TV
	  set-top-box processor is supported. More will be
	  added soon.

menu "ZTE ZX options"
	depends on ARCH_ZX

config SOC_ZX296702
	bool "Enable support for ZX296702 SoC"
	select ARM_GIC
	select ARM_GLOBAL_TIMER
	select HAVE_ARM_SCU if SMP
	select HAVE_ARM_TWD if SMP
	select MIGHT_HAVE_CACHE_L2X0
	help
	  Support for ZTE ZX296702 SoC which is a dual core CortexA9MP

endmenu
```
